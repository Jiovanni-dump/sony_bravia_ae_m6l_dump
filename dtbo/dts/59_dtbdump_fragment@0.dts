/dts-v1/;

/ {

	fragment@0 {
		target = <0xffffffff>;

		__overlay__ {
			status = "okay";
			pinctrl-names = "default";
			pinctrl-0 = <0xffffffff 0xffffffff 0xffffffff>;
		};
	};

	fragment@1 {
		target = <0xffffffff>;

		__overlay__ {
			pinctrl-mt5896,bits = <0x59 0xf0 0x02 0x5c 0x0f 0x02 0x5c 0xf0 0x02 0x5d 0x0f 0x02 0x5d 0xf0 0x02 0x60 0x0f 0x02>;
		};
	};

	fragment@2 {
		target = <0xffffffff>;

		__overlay__ {
			pinctrl-mt5896,bits = <0x54 0xf0 0x04 0x54 0x0f 0x04 0x51 0xf0 0x04 0x51 0x0f 0x04 0x50 0xf0 0x04 0x60 0xf0 0x04>;
		};
	};

	fragment@3 {
		target = <0xffffffff>;

		__overlay__ {
			pinctrl-mt5896,pins = <0x298 0x00>;
			pinctrl-mt5896,drive-strength = <0x07 0x04>;
			pinctrl-mt5896,bias-pulldown = <0x00 0x28 0x00 0x28>;
		};
	};

	__fixups__ {
		mtk_sc = "/fragment@0:target:0";
		smart_card2_pmux_shared = "/fragment@0/__overlay__:pinctrl-0:0\0/fragment@2:target:0";
		smart_card2_pmux = "/fragment@0/__overlay__:pinctrl-0:4\0/fragment@1:target:0";
		smart_card2_pcfg_shared = "/fragment@0/__overlay__:pinctrl-0:8\0/fragment@3:target:0";
	};
};
