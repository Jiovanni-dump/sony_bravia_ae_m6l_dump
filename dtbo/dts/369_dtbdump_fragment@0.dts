/dts-v1/;

/ {

	fragment@0 {
		target = <0xffffffff>;

		__overlay__ {

			lm75 {
				compatible = "ti,tmp100";
				reg = <0x4e>;
				status = "okay";
				phandle = <0x01>;
			};
		};
	};

	__symbols__ {
		lm75 = "/fragment@0/__overlay__/lm75";
	};

	__fixups__ {
		i2c0 = "/fragment@0:target:0";
	};
};
