/dts-v1/;

/ {

	fragment@0 {
		target = <0xffffffff>;

		__overlay__ {

			lm75_dram_nxp {
				compatible = "nxp,pct2075,ro";
				reg = <0x49>;
				status = "okay";
				phandle = <0x01>;
			};
		};
	};

	__symbols__ {
		lm75_dram_nxp = "/fragment@0/__overlay__/lm75_dram_nxp";
	};

	__fixups__ {
		i2c0 = "/fragment@0:target:0";
	};
};
