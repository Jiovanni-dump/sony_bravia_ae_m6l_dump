/dts-v1/;

/ {

	fragment@0 {
		target = <0xffffffff>;

		__overlay__ {

			hw_reserved_1 {
				reg = <0x00 0x20000000 0x00 0x6000000>;
				no-map;
			};

			hw_reserved_2 {
				reg = <0x00 0x8af95000 0x00 0x9400000>;
				no-map;
			};

			hw_reserved_3 {
				reg = <0x00 0x9443f000 0x00 0x8efc1000>;
				no-map;
			};

			default_cma {
				compatible = "shared-dma-pool";
				reg = <0x02 0x1fc00000 0x00 0x400000>;
				reusable;
				linux,cma-default;
			};

			nullmem_1 {
				device_type = "mtk-nullmem";
				reg = <0x01 0xe0000000 0x00 0x10000000>;
			};

			reserved_local_dimming {
				reg = <0x01 0x25000000 0x00 0x800000>;
				reusable;
				mediatek,mpu-nomap;
			};

			rscshm@pmu3 {
				compatible = "shared-dma-pool";
				reg = <0x00 0x8af94000 0x00 0x1000>;
				no-map;
			};

			vdev0vring1@pmu1 {
				compatible = "shared-dma-pool";
				reg = <0x00 0x8af82000 0x00 0x2000>;
				no-map;
			};

			vdev0vring0@pmu0 {
				compatible = "shared-dma-pool";
				reg = <0x00 0x8af80000 0x00 0x2000>;
				no-map;
			};

			pmu_mspi_shm@pmu4 {
				compatible = "shared-dma-pool";
				reg = <0x00 0x8af00000 0x00 0x80000>;
				no-map;
			};

			vdev0buffer@pmu2 {
				compatible = "shared-dma-pool";
				reg = <0x00 0x8af84000 0x00 0x10000>;
				no-map;
			};

			frc_dma_pool@frc0 {
				compatible = "shared-dma-pool";
				reg = <0x00 0x943aa000 0x00 0x15000>;
				no-map;
			};

			pqu_dma_pool@pqu0 {
				compatible = "shared-dma-pool";
				reg = <0x00 0x94395000 0x00 0x15000>;
				no-map;
			};

			hwi2c_mem {
				compatible = "shared-dma-pool";
				reg = <0x00 0x943bf000 0x00 0x80000>;
				no-map;
			};

			cma_22 {
				compatible = "shared-dma-pool";
				heap_name = "RETURN";
				reg = <0x00 0x2fc00000 0x00 0x4000000>;
				reusable;
			};

			cma_23 {
				compatible = "shared-dma-pool";
				heap_name = "OTHERS_RETURN";
				reg = <0x01 0x23400000 0x00 0x1c00000>;
				reusable;
			};

			iommu_carveout@cv0 {
				reg = <0x00 0x8aeff000 0x00 0x1000>;
				mediatek,mpu-map;
			};
		};
	};

	__fixups__ {
		reserved_memory = "/fragment@0:target:0";
	};
};
