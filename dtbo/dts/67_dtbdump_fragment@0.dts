/dts-v1/;

/ {

	fragment@0 {
		target = <0xffffffff>;

		__overlay__ {

			sony_paneldet {
				panel_id = "YDEG002UNG0201";
				phandle = <0x01>;

				oled_panel_control_info {
					compatible = "sony,oled_panel_control";
					panel_out_byte_mode = <0x01>;
					panel_out_byte_mode_reg_addr = <0x23564>;
					panel_out_byte_mode_reg_mask_st = <0x00>;
					panel_out_byte_mode_reg_mask_ed = <0x01>;
				};

				oled_logo_brightness_info {
					compatible = "sony,oled_logo_brightness";
					brightness = <0x6a9>;
					reg_addr = <0x23364>;
					reg_mask_st = <0x00>;
					reg_mask_ed = <0x0d>;
				};

				oled_evdd_pwm_info {
					compatible = "sony,oled_evdd_pwm";
					pwm_chip = <0x00>;
					pwm_channel = <0x00>;
					pwm_period = <0x35de>;
					pwm_duty = <0x2dc8>;
					pwm_invert = <0x00>;
					post_delay_ms = <0x14>;
				};
			};
		};
	};

	fragment@1 {
		target = <0xffffffff>;

		__overlay__ {

			sony_panel {
				panel_id = "YDEG002UNG0201";
				panelAvail;
				inch_size = "42";
				phandle = <0x02>;

				oled_maintenance_info {
					compatible = "sony,panel_refresh";
					keys = "maintenance_support.true\0maintenance_sequence_type.V22_TCON_SEQUENCE\0cooling_time_minutes.0\0cooling_time_minutes_for_retry.5\0cooling_temp_th_low.0\0cooling_temp_th_high.50";
				};
			};

			sony_backlight {
				panelAvail;
				phandle = <0x03>;
			};
		};
	};

	fragment@2 {
		target = <0xffffffff>;

		__overlay__ {
			compatible = "mtk,mt5896-panel";
			status = "okay";
			lane_duplicate = <0x02>;
			#address-cells = <0x02>;
			#size-cells = <0x02>;
			vcc-gpios;
			panel_info_name_list = "panel_info\0panel_info_3840x2160_100\0panel_info_3840x2160_96\0panel_info_3840x2160_60\0panel_info_3840x2160_50\0panel_info_3840x2160_48";

			panel_info {
				panel_name = "WOLED_4K120_16LANE";
				link_type = <0x01>;
				vbo_byte_mode = <0x05>;
				div_section = <0x04>;
				on_timing1 = <0x1e>;
				on_timing2 = <0xc8>;
				off_timing1 = <0xdc>;
				off_timing2 = <0x0a>;
				hsync_start = <0x00>;
				hsync_width = <0x50>;
				hsync_polarity = <0x00>;
				vsync_start = <0x00>;
				vsync_width = <0x08>;
				vsync_polarity = <0x00>;
				de_hstart = <0x1a0>;
				de_vstart = <0x28>;
				resolution_width = <0xf00>;
				resolution_height = <0x870>;
				max_h_total = <0x1120>;
				typ_h_total = <0x1120>;
				min_h_total = <0x1120>;
				max_v_total = <0x8e0>;
				typ_v_total = <0x8d4>;
				min_v_total = <0x8c8>;
				max_v_total_panelprotect = <0x1661>;
				min_v_total_panelprotect = <0x8bf>;
				max_clk = <0x46cf7100>;
				typ_clk = <0x46cf7100>;
				min_clk = <0x46cf7100>;
				typ_clk_high = <0x00>;
				typ_clk_low = <0x46cf7100>;
				output_format = <0x00>;
				content_output_format = <0x00>;
				output_color_range = <0x01>;
				output_color_space = <0x00>;
				vrr_en = <0x01>;
				min_vrr_framerate = <0x1d9>;
				max_vrr_framerate = <0x4ba>;
				graphic_mixer1_outmode = <0x00>;
				graphic_mixer2_outmode = <0x01>;
				GameDirectFrameRateGroup = <0x01>;
			};

			panel_info_3840x2160_100 {
				panel_name = "WOLED_4K100_16LANE";
				link_type = <0x01>;
				vbo_byte_mode = <0x05>;
				div_section = <0x04>;
				on_timing1 = <0x1e>;
				on_timing2 = <0xc8>;
				off_timing1 = <0xdc>;
				off_timing2 = <0x0a>;
				hsync_start = <0x00>;
				hsync_width = <0x50>;
				hsync_polarity = <0x00>;
				vsync_start = <0x00>;
				vsync_width = <0x08>;
				vsync_polarity = <0x00>;
				de_hstart = <0x1a0>;
				de_vstart = <0x28>;
				resolution_width = <0xf00>;
				resolution_height = <0x870>;
				max_h_total = <0x1120>;
				typ_h_total = <0x1120>;
				min_h_total = <0x1120>;
				max_v_total = <0xaa4>;
				typ_v_total = <0xa96>;
				min_v_total = <0xa88>;
				max_v_total_panelprotect = <0x1661>;
				min_v_total_panelprotect = <0x8bf>;
				max_clk = <0x46cf7100>;
				typ_clk = <0x46cf7100>;
				min_clk = <0x46cf7100>;
				typ_clk_high = <0x00>;
				typ_clk_low = <0x46cf7100>;
				output_format = <0x00>;
				content_output_format = <0x00>;
				output_color_range = <0x01>;
				output_color_space = <0x00>;
				vrr_en = <0x01>;
				min_vrr_framerate = <0x1d9>;
				max_vrr_framerate = <0x3ed>;
				graphic_mixer1_outmode = <0x00>;
				graphic_mixer2_outmode = <0x01>;
				GameDirectFrameRateGroup = <0x01>;
			};

			panel_info_3840x2160_96 {
				panel_name = "WOLED_4K96_16LANE";
				link_type = <0x01>;
				vbo_byte_mode = <0x05>;
				div_section = <0x04>;
				on_timing1 = <0x1e>;
				on_timing2 = <0xc8>;
				off_timing1 = <0xdc>;
				off_timing2 = <0x0a>;
				hsync_start = <0x00>;
				hsync_width = <0x50>;
				hsync_polarity = <0x00>;
				vsync_start = <0x00>;
				vsync_width = <0x08>;
				vsync_polarity = <0x00>;
				de_hstart = <0x1a0>;
				de_vstart = <0x28>;
				resolution_width = <0xf00>;
				resolution_height = <0x870>;
				max_h_total = <0x1120>;
				typ_h_total = <0x1120>;
				min_h_total = <0x1120>;
				max_v_total = <0xb17>;
				typ_v_total = <0xb08>;
				min_v_total = <0xaf9>;
				max_v_total_panelprotect = <0x1661>;
				min_v_total_panelprotect = <0x8bf>;
				max_clk = <0x46cf7100>;
				typ_clk = <0x46cf7100>;
				min_clk = <0x46cf7100>;
				typ_clk_high = <0x00>;
				typ_clk_low = <0x46cf7100>;
				output_format = <0x00>;
				content_output_format = <0x00>;
				output_color_range = <0x01>;
				output_color_space = <0x00>;
				vrr_en = <0x01>;
				min_vrr_framerate = <0x1d9>;
				max_vrr_framerate = <0x3c5>;
				graphic_mixer1_outmode = <0x00>;
				graphic_mixer2_outmode = <0x01>;
				GameDirectFrameRateGroup = <0x01>;
			};

			panel_info_3840x2160_60 {
				panel_name = "WOLED_4K60_8LANE";
				link_type = <0x01>;
				vbo_byte_mode = <0x05>;
				div_section = <0x04>;
				on_timing1 = <0x1e>;
				on_timing2 = <0xc8>;
				off_timing1 = <0xdc>;
				off_timing2 = <0x0a>;
				hsync_start = <0x00>;
				hsync_width = <0x50>;
				hsync_polarity = <0x00>;
				vsync_start = <0x00>;
				vsync_width = <0x08>;
				vsync_polarity = <0x00>;
				de_hstart = <0x1a0>;
				de_vstart = <0x28>;
				resolution_width = <0xf00>;
				resolution_height = <0x870>;
				max_h_total = <0x1120>;
				typ_h_total = <0x1120>;
				min_h_total = <0x1120>;
				max_v_total = <0x8e0>;
				typ_v_total = <0x8d4>;
				min_v_total = <0x8c8>;
				max_v_total_panelprotect = <0xb30>;
				min_v_total_panelprotect = <0x8c6>;
				max_clk = <0x2367b880>;
				typ_clk = <0x2367b880>;
				min_clk = <0x2367b880>;
				typ_clk_high = <0x00>;
				typ_clk_low = <0x2367b880>;
				output_format = <0x00>;
				content_output_format = <0x00>;
				output_color_range = <0x01>;
				output_color_space = <0x00>;
				vrr_en = <0x01>;
				min_vrr_framerate = <0x1d9>;
				max_vrr_framerate = <0x25b>;
				graphic_mixer1_outmode = <0x00>;
				graphic_mixer2_outmode = <0x01>;
				GameDirectFrameRateGroup = <0x00>;
			};

			panel_info_3840x2160_50 {
				panel_name = "WOLED_4K50_8LANE";
				link_type = <0x01>;
				vbo_byte_mode = <0x05>;
				div_section = <0x04>;
				on_timing1 = <0x1e>;
				on_timing2 = <0xc8>;
				off_timing1 = <0xdc>;
				off_timing2 = <0x0a>;
				hsync_start = <0x00>;
				hsync_width = <0x50>;
				hsync_polarity = <0x00>;
				vsync_start = <0x00>;
				vsync_width = <0x08>;
				vsync_polarity = <0x00>;
				de_hstart = <0x1a0>;
				de_vstart = <0x28>;
				resolution_width = <0xf00>;
				resolution_height = <0x870>;
				max_h_total = <0x1120>;
				typ_h_total = <0x1120>;
				min_h_total = <0x1120>;
				max_v_total = <0xaa2>;
				typ_v_total = <0xa94>;
				min_v_total = <0xa86>;
				max_v_total_panelprotect = <0xb30>;
				min_v_total_panelprotect = <0x8c6>;
				max_clk = <0x2367b880>;
				typ_clk = <0x2367b880>;
				min_clk = <0x2367b880>;
				typ_clk_high = <0x00>;
				typ_clk_low = <0x2367b880>;
				output_format = <0x00>;
				content_output_format = <0x00>;
				output_color_range = <0x01>;
				output_color_space = <0x00>;
				vrr_en = <0x01>;
				min_vrr_framerate = <0x1d9>;
				max_vrr_framerate = <0x1f7>;
				graphic_mixer1_outmode = <0x00>;
				graphic_mixer2_outmode = <0x01>;
				GameDirectFrameRateGroup = <0x00>;
			};

			panel_info_3840x2160_48 {
				panel_name = "WOLED_4K48_8LANE";
				link_type = <0x01>;
				vbo_byte_mode = <0x05>;
				div_section = <0x04>;
				on_timing1 = <0x1e>;
				on_timing2 = <0xc8>;
				off_timing1 = <0xdc>;
				off_timing2 = <0x0a>;
				hsync_start = <0x00>;
				hsync_width = <0x50>;
				hsync_polarity = <0x00>;
				vsync_start = <0x00>;
				vsync_width = <0x08>;
				vsync_polarity = <0x00>;
				de_hstart = <0x1a0>;
				de_vstart = <0x28>;
				resolution_width = <0xf00>;
				resolution_height = <0x870>;
				max_h_total = <0x1120>;
				typ_h_total = <0x1120>;
				min_h_total = <0x1120>;
				max_v_total = <0xb17>;
				typ_v_total = <0xb08>;
				min_v_total = <0xaf9>;
				max_v_total_panelprotect = <0xb30>;
				min_v_total_panelprotect = <0x8c6>;
				max_clk = <0x2367b880>;
				typ_clk = <0x2367b880>;
				min_clk = <0x2367b880>;
				typ_clk_high = <0x00>;
				typ_clk_low = <0x2367b880>;
				output_format = <0x00>;
				content_output_format = <0x00>;
				output_color_range = <0x01>;
				output_color_space = <0x00>;
				vrr_en = <0x01>;
				min_vrr_framerate = <0x1d9>;
				max_vrr_framerate = <0x1e3>;
				graphic_mixer1_outmode = <0x00>;
				graphic_mixer2_outmode = <0x01>;
				GameDirectFrameRateGroup = <0x00>;
			};

			output_swing_info {
				swing_usr_define = <0x01>;
				common_swing = <0x01>;
				swing_ctrl_lane = <0x18>;
				swing_level = <0x09>;
				phandle = <0x04>;
			};

			output_pre_emphasis {
				pe_usr_define = <0x01>;
				common_pe = <0x01>;
				pe_ctrl_lane = <0x18>;
				pe_level = <0x08>;
				phandle = <0x05>;
			};

			spread_spectrum_info {
				ssc_ctrl_en = <0x01>;
				ssc_modulation = <0x1e>;
				ssc_deviation = <0x1e>;
				phandle = <0x06>;
			};

			usr_lane_order {
				usr_define = <0x01>;
				ctrl_lanes = <0x10>;
				laneorder = <0x00 0x01 0x08 0x09 0x02 0x03 0x0a 0x0b 0x04 0x05 0x0c 0x0d 0x06 0x07 0x0e 0x0f>;
				phandle = <0x07>;
			};

			panel-frc-table-info {
				FRC_TABLE = <0x00 0xa0 0x01 0x04 0xa0 0xd2 0x01 0x03 0xd2 0xf5 0x02 0x05 0xf5 0x104 0x01 0x02 0x104 0x190 0x01 0x02 0x190 0x1fe 0x01 0x01 0x1fe 0xffff 0x01 0x01>;
			};

			panel-color-info {
				COLOR_SPACE = <0x04>;
				COLOR_FORAMT = <0x00>;
				COLOR_RANGE = <0x03>;
				Rx = <0x8a48>;
				Rx_variation = <0x64>;
				Ry = <0x3908>;
				Ry_variation = <0x64>;
				Gx = <0x2134>;
				Gx_variation = <0x64>;
				Gy = <0x9baa>;
				Gy_variation = <0x64>;
				Bx = <0x1996>;
				Bx_variation = <0x64>;
				By = <0x8fc>;
				By_variation = <0x64>;
				Wx = <0x3d13>;
				Wx_variation = <0x64>;
				Wy = <0x4042>;
				Wy_variation = <0x64>;
				MaxLuminance = <0x64>;
				MedLuminance = <0x32>;
				MinLuminance = <0x1f4>;
				LinearRGB = <0x01>;
				HDRPanelNits = <0x18f>;
				DynamicLuminance = <0x00>;
			};

			panel-dither-info {
				dither_out_depth = <0x03>;
				dither_pattern_type = <0x00>;
				dither_capability = <0x01>;
			};

			ext_graph_combo_info {
				graph_vbo_byte_mode = <0x04>;
				phandle = <0x08>;
			};

			mod {
				compatible = "mtk,mt5896-mod";
				reg = <0x00 0x1c484000 0x00 0x1e00>;
				phandle = <0x09>;
			};

			lpll {
				compatible = "mtk,mt5896-lpll";
				reg = <0x00 0x1c486000 0x00 0x200>;
				phandle = <0x0a>;
			};

			oled_info {
				oled_ip_bypass_cust = <0x00>;
				OLED_PixelShift = <0x01>;
			};
		};
	};

	fragment@3 {
		target = <0xffffffff>;

		__overlay__ {
			tgen_version = <0x02>;
			lpll_version = <0x02>;
			mod_version = <0x02>;
			rcon_enable = <0x01>;
			rcon_max = <0x18>;
			rcon_min = <0x08>;
			rcon_value = <0x0f>;
			biascon_single_max = <0x46>;
			biascon_single_min = <0x1e>;
			biascon_single_value = <0x30>;
			biascon_double_max = <0x46>;
			biascon_double_min = <0x1e>;
			biascon_double_value = <0x30>;
			rint_enable = <0x00>;
			rint_max = <0x00>;
			rint_min = <0x00>;
			rint_value = <0x00>;
		};
	};

	fragment@4 {
		target = <0xffffffff>;

		__overlay__ {
			PanelGamma_Enable = <0x00>;
			PanelGamme_BinPath = [00];
			TCON_Enable = <0x00>;
			TCON_BinPath = [00];
			PanelMirrorMode = <0x00>;
			PanelOutputFormat = <0x00>;
			SSC_Enable = <0x00>;
			SSC_Step = <0x00>;
			SSC_Span = <0x00>;
			OverDrive_Enable = <0x00>;
			OverDrive_Buf_Addr = <0x00>;
			OverDrive_Buf_Size = <0x00>;
			GPIO_Backlight = <0x00>;
			VCC_BL_CusCtrl = <0x01>;
			BL_PWM_CusCtrl = <0x01>;
			VBO_Output_CusCtrl = <0x01>;
			M_delta = <0x01>;
			CustomerColorPrimaries = <0x00>;
			SourceWx = <0x3d13>;
			SourceWy = <0x4042>;
			VIDEO_GFX_DISPLAY_MODE = <0x00>;
			OSD_Height = <0x438>;
			OSD_Width = <0x780>;
			OSD_HsyncStart = <0x00>;
			OSD_HsyncEnd = <0x00>;
			OSD_HDEStart = <0x00>;
			OSD_HDEEnd = <0x00>;
			OSD_HTotal = <0x00>;
			OSD_VsyncStart = <0x00>;
			OSD_VsyncEnd = <0x00>;
			OSD_VDEStart = <0x00>;
			OSD_VDEEnd = <0x00>;
			OSD_VTotal = <0x00>;
			cus_x_dpi = <0x50>;
			cus_y_dpi = <0x50>;
			u32PeriodPWM = <0xffff>;
			u32DutyPWM = <0x3fff>;
			u32DivPWM = <0x00>;
			u32ShiftPWM = <0x00>;
			bPolPWM = <0x00>;
			u16MaxPWMvalue = <0xffff>;
			u16MinPWMvalue = <0x2000>;
			u16PWMPort = <0x00>;
			graphic_mixer1_outmode = <0x00>;
			graphic_mixer2_outmode = <0x01>;
			panel_frc_table_type = <0x02>;
			RENDER_IN_COLOR_FORMAT = <0x00>;
			RENDER_IN_COLOR_RANGE = <0x01>;
			RENDER_IN_COLOR_SPACE = <0x00>;
			QHB_Bypass_Enable = <0x00>;
			SCDISP_PATH_SEL = <0x03>;
			MONI_P_EN = <0x00>;
			GameDirectFrameRateMode = <0x01>;
			CTRL_BIT_Enable = <0x01>;
			Freerun_MDelta_Protect = <0x00>;
		};
	};

	fragment@5 {
		target = <0xffffffff>;

		__overlay__ {
			status = "disable";
		};
	};

	fragment@6 {
		target = <0xffffffff>;

		__overlay__ {
			compatible = "mtk,mt5896-gfx-panel";
			status = "disable";
			panel_info_name_list = "panel_info\0loadfw-timing-info";

			panel_info {
				panel_name = "GFX output";
				link_type = <0x01>;
				vbo_byte_mode = <0x05>;
				div_section = <0x01>;
				on_timing1 = <0x1e>;
				on_timing2 = <0xc8>;
				off_timing1 = <0xdc>;
				off_timing2 = <0x0a>;
				hsync_start = <0x00>;
				hsync_width = <0x50>;
				hsync_polarity = <0x00>;
				vsync_start = <0x00>;
				vsync_width = <0x08>;
				vsync_polarity = <0x00>;
				de_hstart = <0x1a0>;
				de_vstart = <0x28>;
				resolution_width = <0xf00>;
				resolution_height = <0x870>;
				max_h_total = <0x1120>;
				typ_h_total = <0x1120>;
				min_h_total = <0x1120>;
				max_v_total = <0x8d8>;
				typ_v_total = <0x8ca>;
				min_v_total = <0x8bc>;
				max_clk = <0x2367b880>;
				typ_clk = <0x2367b880>;
				min_clk = <0x2367b880>;
				typ_clk_high = <0x00>;
				typ_clk_low = <0x2367b880>;
				output_format = <0x08>;
				content_output_format = <0x04>;
				graphic_mixer1_outmode = <0x00>;
				graphic_mixer2_outmode = <0x01>;
			};

			loadfw-timing-info {
				panel_name = "GFX loadfw-timing-info";
				link_type = <0x01>;
				vbo_byte_mode = <0x04>;
				hsync_start = <0x00>;
				hsync_width = <0x58>;
				hsync_polarity = <0x00>;
				vsync_start = <0x00>;
				vsync_width = <0x0a>;
				vsync_polarity = <0x00>;
				de_hstart = <0x180>;
				de_vstart = <0x52>;
				resolution_width = <0xf00>;
				resolution_height = <0x870>;
				max_h_total = <0x1130>;
				typ_h_total = <0x1130>;
				min_h_total = <0x1130>;
				max_v_total = <0x8d8>;
				typ_v_total = <0x8ca>;
				min_v_total = <0x8bc>;
				max_clk = <0x2367b880>;
				typ_clk = <0x2367b880>;
				min_clk = <0x2367b880>;
				typ_clk_high = <0x00>;
				typ_clk_low = <0x2367b880>;
				output_format = <0x08>;
				content_output_format = <0x04>;
				graphic_mixer1_outmode = <0x00>;
				graphic_mixer2_outmode = <0x01>;
			};
		};
	};

	__symbols__ {
		sony_paneldet = "/fragment@0/__overlay__/sony_paneldet";
		sony_pnl_pwr = "/fragment@1/__overlay__/sony_panel";
		sony_bl_pwr = "/fragment@1/__overlay__/sony_backlight";
		output_swing_info = "/fragment@2/__overlay__/output_swing_info";
		output_pre_emphasis = "/fragment@2/__overlay__/output_pre_emphasis";
		spread_spectrum_info = "/fragment@2/__overlay__/spread_spectrum_info";
		usr_lane_order = "/fragment@2/__overlay__/usr_lane_order";
		ext_graph_combo_info = "/fragment@2/__overlay__/ext_graph_combo_info";
		mod = "/fragment@2/__overlay__/mod";
		lpll = "/fragment@2/__overlay__/lpll";
	};

	__fixups__ {
		odm = "/fragment@0:target:0\0/fragment@1:target:0";
		video_out = "/fragment@2:target:0";
		hw_info = "/fragment@3:target:0";
		panel_cus_setting = "/fragment@4:target:0";
		ext_video_out = "/fragment@5:target:0";
		graphic_out = "/fragment@6:target:0";
	};
};
