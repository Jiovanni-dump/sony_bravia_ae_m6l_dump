/dts-v1/;

/ {

	fragment@0 {
		target = <0xffffffff>;

		__overlay__ {
			status = "okay";
		};
	};

	fragment@1 {
		target = <0xffffffff>;

		__overlay__ {
			status = "okay";
		};
	};

	fragment@2 {
		target = <0xffffffff>;

		__overlay__ {
			status = "okay";
		};
	};

	fragment@3 {
		target = <0xffffffff>;

		__overlay__ {
			status = "okay";
		};
	};

	fragment@4 {
		target = <0xffffffff>;

		__overlay__ {
			status = "okay";
		};
	};

	fragment@5 {
		target = <0xffffffff>;

		__overlay__ {
			status = "okay";
		};
	};

	fragment@6 {
		target = <0xffffffff>;

		__overlay__ {

			mali_gop_dma {
				id = <0x05>;
				heaptype = <0x00>;
				max_size = <0x00 0x00>;
				miu = <0x00>;
				normal_zone = <0x00>;
				cache = <0x02>;
			};

			mali_gop {
				id = <0x06>;
				heaptype = <0x00>;
				max_size = <0x00 0x7c000000>;
				miu = <0x00>;
				normal_zone = <0x01>;
				cache = <0x02>;
			};

			img_frame {
				id = <0x09>;
				heaptype = <0x00>;
				max_size = <0x00 0x17bb0000>;
				miu = <0x00>;
				normal_zone = <0x00>;
				cache = <0x01>;
			};

			jpd_write {
				id = <0x0a>;
				heaptype = <0x00>;
				max_size = <0x00 0xbdd8000>;
				miu = <0x00>;
				normal_zone = <0x00>;
				cache = <0x01>;
			};

			jpd_read {
				id = <0x0b>;
				heaptype = <0x00>;
				max_size = <0x00 0x2000000>;
				miu = <0x00>;
				normal_zone = <0x00>;
				cache = <0x01>;
			};

			jpd_inter {
				id = <0x0c>;
				heaptype = <0x00>;
				max_size = <0x00 0xd00000>;
				miu = <0x00>;
				normal_zone = <0x00>;
				cache = <0x01>;
			};

			disp_photo {
				id = <0x0d>;
				heaptype = <0x00>;
				max_size = <0x00 0xfd22000>;
				miu = <0x00>;
				normal_zone = <0x00>;
				cache = <0x01>;
			};

			disp_directfb {
				id = <0x0e>;
				heaptype = <0x00>;
				max_size = <0x00 0x19000000>;
				miu = <0x00>;
				normal_zone = <0x00>;
				cache = <0x00>;
			};

			tsp_fiq {
				id = <0x12>;
				heaptype = <0x00>;
				max_size = <0x00 0x402000>;
				miu = <0x00>;
				normal_zone = <0x00>;
				cache = <0x01>;
			};

			tsp_alppvr {
				id = <0x13>;
				heaptype = <0x00>;
				max_size = <0x00 0xc00000>;
				miu = <0x00>;
				normal_zone = <0x00>;
				cache = <0x01>;
			};

			venc_out_1 {
				id = <0x15>;
				heaptype = <0x00>;
				max_size = <0x00 0x400000>;
				miu = <0x00>;
				normal_zone = <0x00>;
				cache = <0x01>;
			};

			venc_out_2 {
				id = <0x21>;
				heaptype = <0x00>;
				max_size = <0x00 0x400000>;
				miu = <0x00>;
				normal_zone = <0x00>;
				cache = <0x01>;
			};

			venc_in_1 {
				id = <0x22>;
				heaptype = <0x00>;
				max_size = <0x00 0x37d0000>;
				miu = <0x00>;
				normal_zone = <0x00>;
				cache = <0x02>;
			};

			cma_test0 {
				id = <0x23>;
				heaptype = <0x02>;
				max_size = <0x00 0xb00000>;
				miu = <0x00>;
				normal_zone = <0x00>;
				cache = <0x01>;
			};

			venc_work {
				id = <0x26>;
				heaptype = <0x00>;
				max_size = <0x00 0x3c00000>;
				miu = <0x00>;
				normal_zone = <0x00>;
				cache = <0x01>;
			};

			gop_buf {
				id = <0x27>;
				heaptype = <0x00>;
				max_size = <0x00 0x2023000>;
				miu = <0x00>;
				normal_zone = <0x00>;
				cache = <0x00>;
			};

			dip_di_buf {
				id = <0x2b>;
				heaptype = <0x00>;
				max_size = <0x00 0xfd2000>;
				miu = <0x00>;
				normal_zone = <0x00>;
				cache = <0x00>;
			};

			recovery_buf {
				id = <0x2c>;
				heaptype = <0x00>;
				max_size = <0x00 0x17bb0000>;
				miu = <0x00>;
				normal_zone = <0x00>;
				cache = <0x01>;
			};

			shm_buf {
				id = <0x2d>;
				heaptype = <0x00>;
				max_size = <0x00 0x3000>;
				miu = <0x00>;
				normal_zone = <0x00>;
				cache = <0x01>;
			};

			atv_vbi {
				id = <0x2e>;
				heaptype = <0x00>;
				max_size = <0x00 0xc00000>;
				miu = <0x00>;
				normal_zone = <0x00>;
				cache = <0x01>;
			};

			shm_buf_aesdma {
				id = <0x30>;
				heaptype = <0x00>;
				max_size = <0x00 0xd80000>;
				miu = <0x00>;
				normal_zone = <0x00>;
				cache = <0x01>;
			};

			svp_hdl_buf {
				id = <0x32>;
				heaptype = <0x00>;
				max_size = <0x00 0x10000>;
				miu = <0x00>;
				normal_zone = <0x00>;
				cache = <0x01>;
			};

			carveout_test {
				id = <0x33>;
				heaptype = <0x03>;
				max_size = <0x00 0x2000>;
				miu = <0x00>;
				normal_zone = <0x00>;
				cache = <0x01>;
			};

			camera_usage {
				id = <0x35>;
				heaptype = <0x00>;
				max_size = <0x00 0x9000000>;
				miu = <0x00>;
				normal_zone = <0x00>;
				cache = <0x01>;
			};

			dip_capture {
				id = <0x36>;
				heaptype = <0x00>;
				max_size = <0x00 0x2c000000>;
				miu = <0x00>;
				normal_zone = <0x00>;
				cache = <0x00>;
			};

			video_rotation {
				id = <0x37>;
				heaptype = <0x00>;
				max_size = <0x00 0x5eec000>;
				miu = <0x00>;
				normal_zone = <0x00>;
				cache = <0x01>;
			};

			rotation_cap {
				id = <0x38>;
				heaptype = <0x00>;
				max_size = <0x00 0x2f76000>;
				miu = <0x00>;
				normal_zone = <0x00>;
				cache = <0x01>;
			};

			shm_buf_mad_out {
				id = <0x39>;
				heaptype = <0x00>;
				max_size = <0x00 0x80000>;
				miu = <0x00>;
				normal_zone = <0x00>;
				cache = <0x00>;
			};

			mad_buf {
				id = <0x3a>;
				heaptype = <0x00>;
				max_size = <0x00 0x80000>;
				miu = <0x00>;
				normal_zone = <0x00>;
				cache = <0x01>;
			};

			inject_buf {
				id = <0x3b>;
				heaptype = <0x00>;
				max_size = <0x00 0x400000>;
				miu = <0x00>;
				normal_zone = <0x00>;
				cache = <0x01>;
			};

			pvrupload_buf {
				id = <0x3c>;
				heaptype = <0x00>;
				max_size = <0x00 0x400000>;
				miu = <0x00>;
				normal_zone = <0x00>;
				cache = <0x01>;
			};

			secext_buf {
				id = <0x3d>;
				heaptype = <0x00>;
				max_size = <0x00 0x400000>;
				miu = <0x00>;
				normal_zone = <0x00>;
				cache = <0x01>;
			};

			dip_pqu_di_buf {
				id = <0x3e>;
				heaptype = <0x00>;
				max_size = <0x00 0xfd20000>;
				miu = <0x00>;
				normal_zone = <0x00>;
				cache = <0x01>;
			};

			shm_buf_mad {
				id = <0x3f>;
				heaptype = <0x00>;
				max_size = <0x00 0x80000>;
				miu = <0x00>;
				normal_zone = <0x00>;
				cache = <0x01>;
			};

			tsp_sect {
				id = <0x40>;
				heaptype = <0x00>;
				max_size = <0x00 0x4000000>;
				miu = <0x00>;
				normal_zone = <0x00>;
				cache = <0x00>;
			};

			map_sg {
				id = <0x41>;
				heaptype = <0x00>;
				max_size = <0x00 0xffffffff>;
				miu = <0x00>;
				normal_zone = <0x00>;
				cache = <0x01>;
			};

			tsp_alppreparser {
				id = <0x42>;
				heaptype = <0x00>;
				max_size = <0x00 0x1b00000>;
				miu = <0x00>;
				normal_zone = <0x00>;
				cache = <0x01>;
			};

			render_vcom {
				id = <0x43>;
				heaptype = <0x00>;
				max_size = <0x00 0x2000000>;
				miu = <0x00>;
				normal_zone = <0x00>;
				cache = <0x00>;
			};

			ldm_data {
				id = <0x45>;
				heaptype = <0x00>;
				max_size = <0x00 0x8000>;
				miu = <0x00>;
				normal_zone = <0x00>;
				cache = <0x00>;
			};

			demod_buf {
				id = <0x47>;
				heaptype = <0x00>;
				max_size = <0x00 0x1440000>;
				miu = <0x00>;
				normal_zone = <0x00>;
				cache = <0x00>;
			};

			vd_comb {
				id = <0x48>;
				heaptype = <0x00>;
				max_size = <0x00 0x400000>;
				miu = <0x00>;
				normal_zone = <0x00>;
				cache = <0x00>;
			};
		};
	};

	fragment@7 {
		target = <0xffffffff>;

		__overlay__ {
			cma_region_maxsize = <0x00 0x00>;
			mali_threshold = <0x18000000>;
			mali_reduce_migration = <0x01>;
			need_2xiova = <0x02 0x39>;
			need_zeropage = <0x05 0x06>;
			need_dma = <0x01 0x02 0x08 0x16 0x18 0x1b 0x1d>;
		};
	};

	fragment@8 {
		target = <0xffffffff>;

		__overlay__ {

			mdla_area {
				size = <0xec00000>;
				buf_tag_num = <0x01>;
				buf_tag_id = <0x28>;
				phandle = <0x01>;
			};

			aipq_area {
				size = <0x280000>;
				buf_tag_num = <0x01>;
				buf_tag_id = <0x34>;
				phandle = <0x02>;
			};
		};
	};

	__symbols__ {
		mdla_area = "/fragment@8/__overlay__/mdla_area";
		aipq_area = "/fragment@8/__overlay__/aipq_area";
	};

	__fixups__ {
		iommu = "/fragment@0:target:0";
		iommu_test = "/fragment@1:target:0";
		ion_iommu = "/fragment@2:target:0";
		iommu_carveout0 = "/fragment@3:target:0";
		iommu_dmaheap = "/fragment@4:target:0";
		iommu_cma1 = "/fragment@5:target:0";
		buf_tag = "/fragment@6:target:0";
		mem_cust_policy = "/fragment@7:target:0";
		iova_reserved = "/fragment@8:target:0";
	};
};
