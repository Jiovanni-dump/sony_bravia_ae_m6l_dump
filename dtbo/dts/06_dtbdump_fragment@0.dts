/dts-v1/;

/ {
	target-path = "/";

	fragment@0 {
		target = <0xffffffff>;

		__overlay__ {
			pinctrl-names = "default";
			pinctrl-0 = <0xffffffff>;
		};
	};

	fragment@1 {
		target = <0xffffffff>;

		__overlay__ {
			pinctrl-names = "default";
			pinctrl-0 = <0xffffffff 0xffffffff>;
			reg = <0x00 0x1c086400 0x00 0x200 0x00 0x1c020200 0x00 0x200 0x00 0x1c021000 0x00 0x200 0x00 0x1c021200 0x00 0x200 0x00 0x1c620080 0x00 0x02 0x00 0x1c620880 0x00 0x02 0x00 0x1d206000 0x00 0x200 0x00 0x1d2a0800 0x00 0x200 0x00 0x00 0x00 0x200 0x00 0x1d2a0400 0x00 0x200 0x00 0x1c606000 0x00 0x200 0x00 0x1c001800 0x00 0x200 0x00 0x1c001a00 0x00 0x200 0x00 0x1c086000 0x00 0x200 0x00 0x1c086200 0x00 0x200 0x00 0x1c087200 0x00 0x200 0x00 0x1d280000 0x00 0x200 0x00 0x1c025200 0x00 0x200>;
		};
	};

	fragment@2 {
		target = <0xffffffff>;

		__overlay__ {
			pinctrl-names = "default";
			pinctrl-0 = <0xffffffff 0xffffffff>;
		};
	};

	fragment@3 {
		target = <0xffffffff>;

		__overlay__ {
			pinctrl-names = "fun_ldc_tmon_gpio_pmux\0fun_ldc_tmon_pmux\0fun_ldc_in_out_pmux\0fun_gpio\0fun_vsync_like";
			pinctrl-0 = <0xffffffff>;
			pinctrl-1 = <0xffffffff>;
			pinctrl-2 = <0xffffffff>;
			pinctrl-3 = <0xffffffff>;
			pinctrl-4 = <0xffffffff>;
		};
	};

	fragment@4 {
		target = <0xffffffff>;

		__overlay__ {
			pinctrl-names = "fun_ldc_tmon_gpio_pmux\0fun_ldc_tmon_pmux\0fun_ldc_in_out_pmux";
			pinctrl-0 = <0xffffffff>;
			pinctrl-1 = <0xffffffff>;
			pinctrl-2 = <0xffffffff>;
			LDM_SUPPORT = <0x00>;
			LDM_CUS_IP_PATH_uBoot = <0x01>;
			LDM_MMAP_ADDR = <0x00>;
			MX_LDM_VERSION = <0x02>;
			MX_RENDER_QMAP_VERSION = <0x01>;
			LED_MSPI_EN = <0x00>;
			LDM_DMA_SPI_LTP_TEST = <0x01>;
			LDM_MODEL_NO = <0x00>;
			gpios = <0xffffffff 0x09 0x00>;
		};
	};

	fragment@5 {
		target = <0xffffffff>;

		__overlay__ {
			pinctrl-names = "default";
			pinctrl-0 = <0xffffffff 0xffffffff 0xffffffff 0xffffffff 0xffffffff>;
		};
	};

	fragment@6 {
		target = <0xffffffff>;

		__overlay__ {
			pinctrl-names = "default";
			pinctrl-0 = <0xffffffff 0xffffffff 0xffffffff 0xffffffff 0xffffffff>;
		};
	};

	fragment@7 {
		target = <0xffffffff>;

		__overlay__ {
			pre_init_name = "audio_pre_init_mt5897.ini";
			init_name = "audio_init_mt5897.ini";
			speaker_out = <0x00>;
			module-clocks = <0x1c204f38 0x04 0x04 0x1c204f40 0x0c 0x00 0x1c2070e0 0x1000 0x1000 0x1c2071b8 0x4000 0x4000 0x1c204fd0 0x0c 0x04 0x1c204fc8 0x0c 0x04 0x1c204cf0 0x0c 0x08 0x1c204d68 0x1c 0x14 0x1c204f58 0x0c 0x04 0x1c204f60 0x0c 0x04 0x1c204f50 0x0c 0x04 0x1c204e00 0x1c 0x08 0x1c204f70 0x0c 0x04 0x1c204f68 0x1c 0x10 0x1c204e18 0x04 0x04 0x1c204e08 0x04 0x04 0x1c204e10 0x04 0x04 0x1c204cc8 0x0c 0x04 0x1c204d60 0x0c 0x04 0x1c204cc0 0x0c 0x04 0x1c204cb8 0x1c 0x10 0x1c204f48 0x04 0x04 0x1c204d58 0x0c 0x04 0x1c205138 0x01 0x00 0x1c205198 0x07 0x00 0x1c205198 0x07 0x00 0x1c205198 0x08 0x00 0x1c20520c 0x04 0x04 0x1c20519c 0x07 0x00 0x1c20519c 0x07 0x00 0x1c20519c 0x08 0x00 0x1c205210 0x04 0x04 0x1c2051a0 0x07 0x00 0x1c2051a0 0x07 0x00 0x1c2051a0 0x08 0x00 0x1c205214 0x04 0x04 0x1c2051a4 0x07 0x00 0x1c2051a4 0x07 0x00 0x1c2051a4 0x08 0x00 0x1c205218 0x04 0x04 0x1c2051a8 0x07 0x00 0x1c2051a8 0x07 0x00 0x1c2051a8 0x08 0x00 0x1c20521c 0x04 0x04 0x1c2051ac 0x07 0x00 0x1c2051ac 0x07 0x00 0x1c2051ac 0x08 0x00 0x1c205220 0x04 0x04 0x1c2051b0 0x07 0x00 0x1c2051b0 0x07 0x00 0x1c2051b0 0x08 0x00 0x1c205224 0x04 0x04 0x1c2051b4 0x07 0x00 0x1c2051b4 0x07 0x00 0x1c2051b4 0x08 0x00 0x1c205228 0x04 0x04 0x1c2051b8 0x07 0x00 0x1c2051b8 0x07 0x00 0x1c2051b8 0x08 0x00 0x1c20522c 0x04 0x04 0x1c2051bc 0x07 0x00 0x1c2051bc 0x07 0x00 0x1c2051bc 0x08 0x00 0x1c205230 0x04 0x04 0x1c2051c0 0x07 0x00 0x1c2051c0 0x07 0x00 0x1c2051c0 0x08 0x00 0x1c205234 0x04 0x04 0x1c2051c4 0x07 0x00 0x1c2051c4 0x07 0x00 0x1c2051c4 0x08 0x00 0x1c205238 0x04 0x04 0x1c2051c8 0x07 0x00 0x1c2051c8 0x07 0x00 0x1c2051c8 0x08 0x00 0x1c20523c 0x04 0x04 0x1c2051cc 0x07 0x00 0x1c2051cc 0x07 0x00 0x1c2051cc 0x08 0x00 0x1c205240 0x04 0x04 0x1c2051d0 0x07 0x00 0x1c2051d0 0x07 0x00 0x1c2051d0 0x08 0x00 0x1c205244 0x04 0x04 0x1c2051d4 0x07 0x00 0x1c2051d4 0x07 0x00 0x1c2051d4 0x08 0x00 0x1c205248 0x04 0x04 0x1c205058 0x01 0x00 0x1c205058 0x07 0x00 0x1c205058 0x07 0x00 0x1c205058 0x18 0x00 0x1c204d30 0x04 0x04 0x1c205060 0x01 0x00 0x1c205060 0x07 0x00 0x1c205060 0x07 0x00 0x1c205060 0x18 0x00 0x1c204d38 0x04 0x04 0x1c205068 0x01 0x00 0x1c205068 0x07 0x00 0x1c205068 0x07 0x00 0x1c205068 0x18 0x00 0x1c204d40 0x04 0x04 0x1c205070 0x01 0x00 0x1c205070 0x07 0x00 0x1c205070 0x07 0x00 0x1c205070 0x18 0x00 0x1c204d48 0x04 0x04 0x1c205078 0x01 0x00 0x1c205078 0x07 0x00 0x1c205078 0x07 0x00 0x1c205078 0x18 0x00 0x1c204d50 0x04 0x04 0x1c205194 0x01 0x00 0x1c205194 0x07 0x00 0x1c205194 0x07 0x00 0x1c205194 0x18 0x00 0x1c205208 0x04 0x04 0x1c204d70 0x0c 0x04 0x1c205080 0x07 0x00 0x1c205080 0x07 0x00 0x1c2051e0 0x07 0x00 0x1c2051e0 0x07 0x00 0x1c2051e4 0x07 0x00 0x1c2051e4 0x07 0x00 0x1c2050c0 0x07 0x00 0x1c2050c0 0x07 0x00 0x1c2050c0 0x08 0x00 0x1c204d78 0x04 0x04 0x1c2050c0 0x07 0x00 0x1c2050c0 0x07 0x00 0x1c2050c0 0x08 0x00 0x1c204d80 0x0c 0x04 0x1c205090 0x07 0x00 0x1c205090 0x07 0x00 0x1c2051e8 0x07 0x00 0x1c2051e8 0x07 0x00 0x1c2051ec 0x07 0x00 0x1c2051ec 0x07 0x00 0x1c2050c8 0x07 0x00 0x1c2050c8 0x07 0x00 0x1c2050c8 0x08 0x00 0x1c204d88 0x04 0x04 0x1c2050c8 0x07 0x00 0x1c2050c8 0x07 0x00 0x1c2050c8 0x08 0x00 0x1c204d90 0x0c 0x04 0x1c2050a0 0x07 0x00 0x1c2050a0 0x07 0x00 0x1c2051f0 0x07 0x00 0x1c2051f0 0x07 0x00 0x1c2051f4 0x07 0x00 0x1c2051f4 0x07 0x00 0x1c2050d0 0x07 0x00 0x1c2050d0 0x07 0x00 0x1c2050d0 0x08 0x00 0x1c204d98 0x04 0x04 0x1c2050d0 0x07 0x00 0x1c2050d0 0x07 0x00 0x1c2050d0 0x08 0x00 0x1c204da0 0x0c 0x04 0x1c2050b0 0x07 0x00 0x1c2050b0 0x07 0x00 0x1c2051f8 0x07 0x00 0x1c2051f8 0x07 0x00 0x1c2051fc 0x07 0x00 0x1c2051fc 0x07 0x00 0x1c2050d8 0x07 0x07 0x1c2050d8 0x07 0x07 0x1c2050d8 0x08 0x00 0x1c204da8 0x04 0x04 0x1c2050d8 0x07 0x07 0x1c2050d8 0x07 0x07 0x1c2050d8 0x08 0x00 0x1c204db0 0x04 0x04 0x1c204db8 0x04 0x04 0x1c204cd8 0x1c 0x04 0x1c205020 0x01 0x01 0x1c204cd0 0x04 0x04 0x1c204ce8 0x1c 0x04 0x1c204ce0 0x04 0x04 0x1c204f88 0x04 0x04 0x1c204f90 0x04 0x04 0x1c204f98 0x0c 0x04 0x1c204e60 0x04 0x04 0x1c2050f8 0x01 0x00 0x1c204e58 0x04 0x04 0x1c2050f8 0x01 0x00 0x1c204e50 0x04 0x04 0x1c204e48 0x04 0x04 0x1c204e38 0x04 0x04 0x1c2050f0 0x01 0x00 0x1c204e30 0x04 0x04 0x1c2050f0 0x01 0x00 0x1c204e28 0x04 0x04 0x1c204e20 0x04 0x04 0x1c204d00 0x0c 0x04 0x1c204ed0 0x1c 0x14 0x1c204e90 0x04 0x04 0x1c204ea8 0x1c 0x0c 0x1c204cf8 0x0c 0x04 0x1c204ec8 0x1c 0x14 0x1c204e88 0x04 0x04 0x1c204d08 0x1c 0x0c 0x1c205118 0x01 0x00 0x1c205118 0x01 0x00 0x1c205118 0x01 0x00 0x1c205118 0x01 0x00 0x1c205128 0x01 0x00 0x1c205128 0x01 0x00 0x1c205128 0x01 0x00 0x1c205128 0x01 0x00 0x1c204ec0 0x04 0x04 0x1c204ea0 0x04 0x04 0x1c204ee0 0x1c 0x10 0x1c205130 0x01 0x00 0x1c204e98 0x0c 0x04 0x1c205130 0x01 0x00 0x1c205130 0x01 0x00 0x1c205130 0x01 0x00 0x1c205030 0x07 0x04 0x1c204ca8 0x04 0x04 0x1c205184 0x0c 0x04 0x1c204ed8 0x1c 0x1c 0x1c205120 0x01 0x00 0x1c204e80 0x0c 0x04 0x1c205120 0x01 0x00 0x1c205120 0x01 0x00 0x1c205120 0x01 0x00 0x1c205028 0x07 0x04 0x1c204ca0 0x04 0x04 0x1c204eb8 0x1c 0x04 0x1c204eb0 0x0c 0x04 0x1c204f20 0x04 0x04 0x1c204f28 0x04 0x04 0x1c205178 0x03 0x00 0x1c205180 0x07 0x00 0x1c204fb8 0x04 0x04 0x1c205178 0x03 0x00 0x1c205180 0x07 0x00 0x1c204fb0 0x04 0x04 0x1c204fc0 0x04 0x04 0x1c205168 0x03 0x00 0x1c205170 0x07 0x00 0x1c204fa8 0x04 0x04 0x1c205168 0x03 0x00 0x1c205170 0x07 0x00 0x1c204fa0 0x04 0x04 0x1c204f18 0x0c 0x04 0x1c204ee8 0x0c 0x04 0x1c204ef0 0x0c 0x04 0x1c204f00 0x0c 0x04 0x1c204ef8 0x04 0x04 0x1c204f10 0x0c 0x04 0x1c204f08 0x04 0x04 0x1c205110 0x01 0x00 0x1c205108 0x01 0x00 0x1c205100 0x01 0x00 0x1c204e78 0x04 0x04 0x1c204e70 0x04 0x04 0x1c205150 0x07 0x00 0x1c205148 0x07 0x00 0x1c205160 0x01 0x00 0x1c205158 0x01 0x00 0x1c204f80 0x04 0x04 0x1c204df8 0x0c 0x08 0x1c204dd8 0x04 0x04 0x1c204df0 0x04 0x04 0x1c2050e0 0x03 0x00 0x1c2050e8 0x07 0x00 0x1c204cb0 0x04 0x04 0x1c204de0 0x04 0x04 0x1c204dd0 0x04 0x04 0x1c204dc0 0x04 0x04 0x1c204dc8 0x04 0x04 0x1c2050e8 0x07 0x00 0x1c204de8 0x04 0x04 0x1c204f78 0x04 0x04 0x1c204fd8 0x04 0x04 0x1c205264 0x0c 0x04 0x1c205258 0x1c 0x04 0x1c205260 0x04 0x04 0x1c20525c 0x04 0x04 0x1c20524c 0x1c 0x04 0x1c205254 0x04 0x04 0x1c205250 0x04 0x04 0x1c205b94 0x01 0x01 0x1c205b98 0x01 0x01 0x1c205ba0 0x01 0x01 0x1c205ba4 0x01 0x01 0x1c205ba8 0x01 0x01 0x1c205bac 0x01 0x01 0x1c205bb0 0x01 0x01 0x1c205bb4 0x01 0x01 0x1c205bb8 0x01 0x01 0x1c205bbc 0x01 0x01 0x1c205bc0 0x01 0x01 0x1c205bc4 0x01 0x01 0x1c205bc8 0x01 0x01 0x1c205bcc 0x01 0x01 0x1c205bd0 0x01 0x01 0x1c205bd4 0x01 0x01 0x1c205bd8 0x01 0x01 0x1c205bdc 0x01 0x01 0x1c205be0 0x01 0x01 0x1c205be4 0x01 0x01 0x1c205be8 0x01 0x01 0x1c205bec 0x01 0x01 0x1c205bf0 0x01 0x01 0x1c205bf4 0x01 0x01 0x1c205bf8 0x01 0x01 0x1c205bfc 0x01 0x01 0x1c205c00 0x01 0x01 0x1c205c04 0x01 0x01 0x1c205c08 0x01 0x01 0x1c205c0c 0x01 0x01 0x1c205c10 0x01 0x01 0x1c205c14 0x01 0x01 0x1c205c18 0x01 0x01 0x1c205c1c 0x01 0x01 0x1c205c20 0x01 0x01 0x1c205c24 0x01 0x01 0x1c205c28 0x01 0x01 0x1c205c2c 0x01 0x01 0x1c205c30 0x01 0x01 0x1c205c34 0x01 0x01 0x1c205c38 0x01 0x01 0x1c205c3c 0x01 0x01 0x1c205c40 0x01 0x01 0x1c205c44 0x01 0x01 0x1c205c48 0x01 0x01 0x1c205c4c 0x01 0x01 0x1c205c50 0x01 0x01 0x1c205c54 0x01 0x01 0x1c205c58 0x01 0x01 0x1c205c5c 0x01 0x01 0x1c205c60 0x01 0x01 0x1c205c64 0x01 0x01 0x1c205c68 0x01 0x01 0x1c205c6c 0x01 0x01 0x1c205c70 0x01 0x01 0x1c205c74 0x01 0x01 0x1c205c78 0x01 0x01 0x1c205c7c 0x01 0x01 0x1c205c80 0x01 0x01 0x1c205c84 0x01 0x01 0x1c205c88 0x01 0x01 0x1c205c8c 0x01 0x01 0x1c205c90 0x01 0x01 0x1c205c94 0x01 0x01 0x1c205c98 0x01 0x01 0x1c205c9c 0x01 0x01 0x1c205ca0 0x01 0x01 0x1c205ca4 0x01 0x01 0x1c205ca8 0x01 0x01 0x1c205cac 0x01 0x01 0x1c205cb0 0x01 0x01 0x1c205cb4 0x01 0x01 0x1c205cb8 0x01 0x01 0x1c205cbc 0x01 0x01 0x1c205cc0 0x01 0x01 0x1c205cc4 0x01 0x01 0x1c205cc8 0x01 0x01 0x1c205ccc 0x01 0x01 0x1c205cd0 0x01 0x01 0x1c205cd4 0x01 0x01 0x1c205cd8 0x01 0x01 0x1c205cdc 0x01 0x01 0x1c205ce0 0x01 0x01 0x1c205ce4 0x01 0x01 0x1c205ce8 0x01 0x01 0x1c205cec 0x01 0x01 0x1c205cf0 0x01 0x01 0x1c205cf4 0x01 0x01 0x1c205cf8 0x01 0x01 0x1c205cfc 0x01 0x01 0x1c205d00 0x01 0x01 0x1c205d04 0x01 0x01 0x1c205d08 0x01 0x01 0x1c205d0c 0x01 0x01 0x1c205d10 0x01 0x01 0x1c205d14 0x01 0x01 0x1c205d18 0x01 0x01 0x1c205d1c 0x01 0x01 0x1c205d20 0x01 0x01 0x1c205d24 0x01 0x01 0x1c205d28 0x01 0x01 0x1c205d2c 0x01 0x01 0x1c205d30 0x01 0x01 0x1c205d34 0x01 0x01 0x1c205d38 0x01 0x01 0x1c205d3c 0x01 0x01 0x1c205d40 0x01 0x01 0x1c205d44 0x01 0x01 0x1c205d48 0x01 0x01 0x1c205d4c 0x01 0x01 0x1c205d50 0x01 0x01 0x1c205d54 0x01 0x01 0x1c205d58 0x01 0x01 0x1c205d5c 0x01 0x01 0x1c205d60 0x01 0x01 0x1c205d68 0x01 0x01 0x1c205d6c 0x01 0x01 0x1c205d7c 0x01 0x01 0x1c205e00 0x01 0x01 0x1c205e04 0x01 0x01 0x1c205e08 0x01 0x01 0x1c205e0c 0x01 0x01 0x1c205e10 0x01 0x01 0x1c205e14 0x01 0x01 0x1c205e18 0x01 0x01 0x1c205e1c 0x01 0x01 0x1c205e20 0x01 0x01 0x1c205e24 0x01 0x01 0x1c205e28 0x01 0x01 0x1c205e2c 0x01 0x01 0x1c205e30 0x01 0x01 0x1c205e34 0x01 0x01 0x1c205e38 0x01 0x01 0x1c205e3c 0x01 0x01 0x1c205e40 0x01 0x01 0x1c205e44 0x01 0x01 0x1c205e48 0x01 0x01 0x1c205e4c 0x01 0x01 0x1c205e50 0x01 0x01 0x1c205e54 0x01 0x01 0x1c205e58 0x01 0x01 0x1c205e5c 0x01 0x01 0x1c205e60 0x01 0x01 0x1c205e64 0x01 0x01 0x1c205e68 0x01 0x01 0x1c205e6c 0x01 0x01 0x1c205e70 0x01 0x01 0x1c205e74 0x01 0x01 0x1c205e78 0x01 0x01 0x1c205e7c 0x01 0x01 0x1c205e80 0x01 0x01 0x1c205e84 0x01 0x01 0x1c205e88 0x01 0x01 0x1c205e8c 0x01 0x01 0x1c205e90 0x01 0x01 0x1c205e94 0x01 0x01 0x1c205e98 0x01 0x01>;
		};
	};

	fragment@8 {
		target = <0xffffffff>;

		__overlay__ {

			usb-phy@1C780000 {
				mediatek,eye-ls-sr = <0x02>;
				mediatek,eye-pre-em = <0x02>;
			};

			usb-phy@1C781000 {
				mediatek,eye-ls-sr = <0x02>;
				mediatek,eye-pre-em = <0x02>;
			};

			usb-phy@1C782000 {
				mediatek,eye-ls-sr = <0x02>;
				mediatek,eye-pre-em = <0x02>;
			};

			usb-phy@1C780700 {
			};
		};
	};

	fragment@9 {
		target = <0xffffffff>;

		__overlay__ {

			usb-phy@1C1A0000 {
				mediatek,eye-ls-sr = <0x02>;
				mediatek,eye-pre-em = <0x02>;
			};

			usb-phy@1C1A0700 {
			};
		};
	};

	fragment@10 {
		target = <0xffffffff>;

		__overlay__ {
			vbus-gpios = <0xffffffff 0x2c 0x00 0xffffffff 0x2d 0x00 0xffffffff 0x2b 0x00>;
			ocp-gpios = <0xffffffff 0x3d 0x01 0xffffffff 0x2e 0x01 0xffffffff 0x3a 0x01>;
			u3-comp-dix = <0x0f 0x00 0x0f>;
		};
	};

	fragment@11 {
		target = <0xffffffff>;

		__overlay__ {
			vbus-gpios = <0xffffffff 0x04 0x00>;
			u3-comp-dix = <0x00>;
		};
	};

	fragment@12 {
		target = <0xffffffff>;

		__overlay__ {
			u3_port_shift = <0x01>;
			resume-disable-port = <0x01>;
		};
	};

	fragment@13 {
		target = <0xffffffff>;

		__overlay__ {
			support-dma;
			pinctrl-names = "default";
			pinctrl-0 = <0xffffffff>;
			clock-frequency = <0x186a0>;
			scl-stretch;
			bus-number = <0x00>;
		};
	};

	fragment@14 {
		target = <0xffffffff>;

		__overlay__ {
			support-dma;
			pinctrl-names = "default";
			pinctrl-0 = <0xffffffff>;
			clock-frequency = <0x186a0>;
			scl-stretch;
			bus-number = <0x01>;
		};
	};

	fragment@15 {
		target = <0xffffffff>;

		__overlay__ {
			support-dma;
			pinctrl-names = "default";
			pinctrl-0 = <0xffffffff>;
			clock-frequency = <0x186a0>;
			scl-stretch;
			bus-number = <0x02>;
		};
	};

	fragment@16 {
		target = <0xffffffff>;

		__overlay__ {
			support-dma;
			pinctrl-names = "default";
			pinctrl-0 = <0xffffffff>;
			clock-frequency = <0x186a0>;
			scl-stretch;
			bus-number = <0x03>;
		};
	};

	fragment@17 {
		target = <0xffffffff>;

		__overlay__ {
			status = "disabled";
		};
	};

	fragment@18 {
		target = <0xffffffff>;

		__overlay__ {
			status = "disabled";
		};
	};

	fragment@19 {
		target = <0xffffffff>;

		__overlay__ {
			pinctrl-names = "default";
			pinctrl-0 = <0xffffffff>;
			clock-frequency = <0x186a0>;
			scl-stretch;
			bus-number = <0x05>;
		};
	};

	fragment@20 {
		target = <0xffffffff>;

		__overlay__ {
		};
	};

	fragment@21 {
		target = <0xffffffff>;

		__overlay__ {
		};
	};

	fragment@22 {
		target = <0xffffffff>;

		__overlay__ {
		};
	};

	fragment@23 {
		target = <0xffffffff>;

		__overlay__ {
		};
	};

	fragment@24 {
		target = <0xffffffff>;

		__overlay__ {
		};
	};

	fragment@25 {
		target = <0xffffffff>;

		__overlay__ {
			reg = <0x00 0x1c646100 0x00 0x80>;
		};
	};

	fragment@26 {
		target = <0xffffffff>;

		__overlay__ {
			reg = <0x00 0x1c647100 0x00 0x80>;
			high-speed-uart;
			uart-synth-reg = <0x1c600e00>;
			uart-synth-clk-index = <0x01>;
		};
	};

	fragment@27 {
		target = <0xffffffff>;

		__overlay__ {
			reg = <0x00 0x1c647200 0x00 0x80>;
		};
	};

	fragment@28 {
		target = <0xffffffff>;

		__overlay__ {
			reg = <0x00 0x1c061080 0x00 0x80>;
		};
	};

	fragment@29 {
		target = <0xffffffff>;

		__overlay__ {
			status = "disabled";
		};
	};

	fragment@30 {
		target = <0xffffffff>;

		__overlay__ {
			status = "disabled";
		};
	};

	fragment@31 {
		target = <0xffffffff>;

		__overlay__ {
		};
	};

	fragment@32 {
		target = <0xffffffff>;

		__overlay__ {
		};
	};

	fragment@33 {
		target = <0xffffffff>;

		__overlay__ {
		};
	};

	fragment@34 {
		target = <0xffffffff>;

		__overlay__ {
		};
	};

	fragment@35 {
		target = <0xffffffff>;

		__overlay__ {
			tgen_version = <0x02>;
			lpll_version = <0x02>;
			mod_version = <0x02>;
			rcon_enable = <0x01>;
			rcon_max = <0x18>;
			rcon_min = <0x08>;
			rcon_value = <0x0f>;
			biascon_single_max = <0x46>;
			biascon_single_min = <0x1e>;
			biascon_single_value = <0x30>;
			biascon_double_max = <0x46>;
			biascon_double_min = <0x1e>;
			biascon_double_value = <0x30>;
			rint_enable = <0x00>;
			rint_max = <0x00>;
			rint_min = <0x00>;
			rint_value = <0x00>;
			pnl_lib_version = <0x02>;
		};
	};

	fragment@36 {
		target = <0xffffffff>;

		__overlay__ {
		};
	};

	fragment@37 {
		target = <0xffffffff>;

		__overlay__ {

			ld_vsync-hog {
				gpio-hog;
				gpios = <0x09 0x00>;
				output-low;
				line-name = "ld-vsync-gpio";
			};
		};
	};

	fragment@38 {
		target = <0xffffffff>;

		__overlay__ {

			led0 {
				label = "mtk-tv:red:standby";
				gpios = <0xffffffff 0x1d 0x00>;
				color = <0x01>;
				default-state = "on";
				status = "disable";
			};

			led1 {
				label = "mtk-tv:green:on";
				gpios = <0xffffffff 0x1e 0x01>;
				color = <0x02>;
				default-state = "on";
				status = "okay";
			};
		};
	};

	fragment@39 {
		target = <0xffffffff>;

		__overlay__ {
			phy-type = <0x00>;
		};
	};

	fragment@40 {
		target = <0xffffffff>;

		__overlay__ {
			firmware-prefix = "/pmu/pmu_mt5896_1696";
			dtbo-path = "/pmu/pmu_mt5897_h1v1_b6_s.dtbo";
		};
	};

	fragment@41 {
		target = <0xffffffff>;

		__overlay__ {
			compatible = "mediatek,pmu_ini";
			reg = <0x00 0x1c020200 0x00 0x200>;

			gpio-control {
				compatible = "mediatek,gpio-control";
				nonpm-gpio-nbase = <0x00>;
				nonpm-gpio-ngpio = <0x8b>;
				pm-gpio-nbase = <0xc8>;
				pm-gpio-ngpio = <0x64>;
				status = "okay";
			};

			wifi-gpio {
				compatible = "mediatek,wifi-gpio";
				wakeup-gpio-num = <0xde>;
				wakeup-virq = <0x516>;
				wakeup-virq-polar = <0x01>;
				status = "okay";
			};

			bt-gpio {
				compatible = "mediatek,bt-gpio";
				wakeup-gpio-num = <0xdd>;
				wakeup-virq = <0x515>;
				wakeup-virq-polar = <0x01>;
				status = "okay";
			};

			emer-gpio {
				compatible = "mediatek,emer-gpio";
				wakeup-gpio-num = <0xdead>;
				wakeup-virq = <0xdead>;
				wakeup-virq-polar = <0x01>;
				status = "disabled";
			};

			voc_ext_dsp {
				compatible = "mediatek,voc_ext_dsp";
				wakeup-gpio-num = <0x00>;
				wakeup-virq = <0x00>;
				wakeup-virq-polar = <0x00>;
				status = "disabled";
			};

			wifi-reset {
				compatible = "mediatek,mtk-wifi-reset";
				reset-gpio-num = <0xd8>;
				default-gpio-val = <0x01>;
				invert-ms = <0x05>;
				status = "okay";
			};

			mute-gpio {
				compatible = "mediatek,mute-gpio";
				wakeup-gpio-num = <0xffff>;
			};

			hdmi-33v-ctrl {
				compatible = "mediatek,hdmi-33v-ctrl";
				hdmi-33v-gpio-num = <0xffff>;
				status = "disabled";
			};
		};
	};

	fragment@42 {
		target = <0xffffffff>;

		__overlay__ {
			capability = <0x801a>;
			firmware-prefix = "/vad/vad_mt5897_1696";
			dtbo-path = "/vad/vad_mt5897_h1v1_b6_s.dtbo";
			reg = <0x00 0x1c086400 0x00 0x200 0x00 0x1c020200 0x00 0x200 0x00 0x1c021000 0x00 0x200 0x00 0x1c021200 0x00 0x200 0x00 0x1c620080 0x00 0x02 0x00 0x1c620880 0x00 0x02 0x00 0x1d206000 0x00 0x200 0x00 0x1d2a0800 0x00 0x200 0x00 0x1c087000 0x00 0x200 0x00 0x1d2a0400 0x00 0x200 0x00 0x1c606000 0x00 0x200 0x00 0x1c001800 0x00 0x200 0x00 0x1c001a00 0x00 0x200 0x00 0x1c086000 0x00 0x200 0x00 0x1c086200 0x00 0x200 0x00 0x1c087200 0x00 0x200 0x00 0x1d280000 0x00 0x200 0x00 0x1c025200 0x00 0x200>;
		};
	};

	fragment@43 {
		target = <0xffffffff>;

		__overlay__ {

			tuner-mxl661@60 {
				compatible = "mtk, mxl661";
				reg = <0x60>;
				unique_id = <0x6056>;
				i2c_slave_id = <0x60>;
				delivery_system = <0x01 0x02 0x03 0x08 0x0b 0x0d 0x10 0x13>;
				xtal_cap = <0x1f>;
				gpio_id = <0x00>;
			};

			tuner-av2017@63 {
				compatible = "mtk, av2017";
				reg = <0x63>;
				unique_id = <0x6057>;
				i2c_slave_id = <0x63>;
				delivery_system = <0x05 0x06>;
			};

			tuner-si2151@64 {
				compatible = "mtk, si2151";
				reg = <0x64>;
				unique_id = <0x6058>;
				i2c_slave_id = <0x00>;
				delivery_system = <0x01 0x02 0x03 0x08 0x0b 0x0d 0x10 0x13>;
				xtal_cap = <0x00>;
				gpio_id = <0x00>;
			};

			tuner-rda5815@0c {
				compatible = "mtk, rda5815";
				reg = <0x0c>;
				unique_id = <0xc59>;
				i2c_slave_id = <0x00>;
				delivery_system = <0x05 0x06>;
			};

			tuner-av2018@62 {
				compatible = "mtk, av2018";
				reg = <0x62>;
				unique_id = <0x605a>;
				i2c_slave_id = <0x00>;
				delivery_system = <0x05 0x06>;
			};

			tuner-cxd686@65 {
				compatible = "mtk, cxd686";
				reg = <0x65>;
				unique_id = <0x6060>;
				i2c_slave_id = <0x60>;
				gpio_id = <0xff>;
				delivery_system = <0x01 0x02 0x03 0x05 0x06 0x08 0x0b 0x0d 0x10 0x13>;
			};

			tuner-r842@66 {
				compatible = "mtk, r842";
				reg = <0x66>;
				unique_id = <0x607b>;
				i2c_slave_id = <0x7b>;
				delivery_system = <0x01 0x02 0x03 0x08 0x0b 0x0d 0x10 0x13>;
			};

			mtk-austin-demod@79 {
				compatible = "austin_demod";
				reg = <0x79>;
				i2c_slave_id = <0x79>;
				unique_id = <0x01>;
			};
		};
	};

	fragment@44 {
		target = <0xffffffff>;

		__overlay__ {
			support_lanes = <0x28>;
			layout_order = <0x00 0x01 0x02 0x03 0x04 0x05 0x06 0x07 0x08 0x09 0x0a 0x0b 0x0c 0x0d 0x0e 0x0f 0x10 0x11 0x12 0x13 0x14 0x15 0x16 0x17 0x18 0x19 0x1a 0x1b 0x1c 0x1d 0x1e 0x1f 0x20 0x21 0x22 0x23 0x24 0x25 0x26 0x27>;
		};
	};

	fragment@45 {
		target = <0xffffffff>;

		__overlay__ {
			vcc-gpios = <0xffffffff 0x45 0x01>;
		};
	};

	fragment@46 {
		target = <0xffffffff>;

		__overlay__ {

			panel-color-info {
				GOP0HDRMode = <0x00>;
			};
		};
	};

	fragment@47 {
		target = <0xffffffff>;

		__overlay__ {
			pol = <0x00>;
		};
	};

	fragment@48 {
		target = <0xffffffff>;

		__overlay__ {
			pol = <0x00>;
		};
	};

	fragment@49 {
		target = <0xffffffff>;

		__overlay__ {
			u16PWMPort = <0x04>;
		};
	};

	fragment@50 {
		target = <0xffffffff>;

		__overlay__ {
			extcon-gpios = <0xffffffff 0x06 0x00>;
		};
	};

	fragment@51 {
		target = <0xffffffff>;

		__overlay__ {
			pinctrl-names = "default";
			pinctrl-0 = <0xffffffff>;
		};
	};

	fragment@52 {
		target = <0xffffffff>;

		__overlay__ {
			reg = <0x00 0x1c4876c0 0x00 0x40 0x00 0x1c4877c0 0x00 0x40 0x00 0x1c487200 0x00 0x40>;
			pinctrl-names = "default";
			pinctrl-0 = <0xffffffff>;
		};
	};

	fragment@53 {
		target = <0xffffffff>;

		__overlay__ {
			pinctrl-names = "default";
			pinctrl-0 = <0xffffffff>;
		};
	};

	__overlay__ {

		dummy_pcb_node {
			status = "disabled";
		};
	};

	fragment@54 {
		target = <0xffffffff>;

		__overlay__ {
			pinctrl-names = "default";
			pinctrl-0 = <0xffffffff>;
		};
	};

	fragment@55 {
		target = <0xffffffff>;

		__overlay__ {
			pinctrl-mt5896,bits = <0x48 0xf0 0x01 0x49 0x0f 0x01>;
			pinctrl-mtk,pins = <0x48 0xf0 0x01 0x49 0x0f 0x01>;
		};
	};

	fragment@56 {
		target = <0xffffffff>;

		__overlay__ {
			pinctrl-mt5896,bits = <0x49 0xf0 0x04 0x4c 0x0f 0x04>;
			pinctrl-mtk,pins = <0x49 0xf0 0x04 0x4c 0x0f 0x04>;
		};
	};

	fragment@57 {
		target = <0xffffffff>;

		__overlay__ {
			pinctrl-mt5896,bits = <0x85 0xf0 0x01 0x88 0x0f 0x01>;
			pinctrl-mtk,pins = <0x85 0xf0 0x01 0x88 0x0f 0x01>;
		};
	};

	fragment@58 {
		target = <0xffffffff>;

		__overlay__ {
			pinctrl-mt5896,bits = <0x4d 0x0f 0x01 0x4c 0xf0 0x01>;
			pinctrl-mtk,pins = <0x4d 0x0f 0x01 0x4c 0xf0 0x01>;
		};
	};

	fragment@59 {
		target = <0xffffffff>;

		__overlay__ {
			pinctrl-mt5896,bits = <0x61 0x0f 0x01 0x61 0xf0 0x01 0x64 0x0f 0x01 0x64 0xf0 0x01 0x65 0x0f 0x01>;
			pinctrl-mtk,pins = <0x61 0x0f 0x01 0x61 0xf0 0x01 0x64 0x0f 0x01 0x64 0xf0 0x01 0x65 0x0f 0x01>;
		};
	};

	fragment@60 {
		target = <0xffffffff>;

		__overlay__ {
			pinctrl-mt5896,bits = <0x70 0x0f 0x01 0x6c 0xf0 0x01 0x6d 0x0f 0x01 0x6d 0xf0 0x01 0x6c 0x0f 0x02>;
			pinctrl-mtk,pins = <0x70 0x0f 0x01 0x6c 0xf0 0x01 0x6d 0x0f 0x01 0x6d 0xf0 0x01 0x6c 0x0f 0x02>;
		};
	};

	fragment@61 {
		target = <0xffffffff>;

		__overlay__ {
			pinctrl-mt5896,bits = <0x65 0xf0 0x02 0x68 0x0f 0x02 0x68 0xf0 0x02 0x69 0x0f 0x02 0x69 0xf0 0x02>;
		};
	};

	fragment@62 {
		target = <0xffffffff>;

		__overlay__ {
			pinctrl-mt5896,bits = <0x49 0xf0 0x04 0x4c 0xf0 0x04 0x4d 0x0f 0x04 0x49 0x0f 0x04 0x50 0x0f 0x04>;
		};
	};

	fragment@63 {
		target = <0xffffffff>;

		__overlay__ {
			pinctrl-mt5896,bits = <0x54 0x0f 0x01 0x55 0x0f 0x01 0x55 0xf0 0x01 0x58 0xf0 0x01 0x59 0x0f 0x01>;
		};
	};

	fragment@64 {
		target = <0xffffffff>;

		__overlay__ {
			pinctrl-mt5896,bits = <0x54 0xf0 0x04 0x54 0x0f 0x04 0x51 0xf0 0x04 0x51 0x0f 0x04 0x50 0xf0 0x04>;
		};
	};

	fragment@65 {
		target = <0xffffffff>;

		__overlay__ {
			pinctrl-mt5896,bits = <0x59 0xf0 0x01 0x5c 0x0f 0x01 0x5c 0xf0 0x01 0x5d 0x0f 0x01 0x5d 0xf0 0x01>;
		};
	};

	fragment@66 {
		target = <0xffffffff>;

		__overlay__ {
			pinctrl-mt5896,bits = <0x4c 0x0f 0x04 0x4d 0xf0 0x04>;
		};
	};

	fragment@67 {
		target = <0xffffffff>;

		__overlay__ {
			pinctrl-mt5896,bits = <0x54 0xf0 0x01 0x58 0x0f 0x01>;
		};
	};

	fragment@68 {
		target = <0xffffffff>;

		__overlay__ {
			pinctrl-mt5896,bits = <0x61 0x0f 0x01 0x61 0xf0 0x01 0x64 0x0f 0x01 0x64 0xf0 0x01 0x65 0x0f 0x01 0x65 0xf0 0x01 0x68 0x0f 0x01 0x68 0xf0 0x01 0x69 0x0f 0x01 0x69 0xf0 0x01 0x6c 0x0f 0x01>;
			pinctrl-mtk,pins = <0x61 0x0f 0x01 0x61 0xf0 0x01 0x64 0x0f 0x01 0x64 0xf0 0x01 0x65 0x0f 0x01 0x65 0xf0 0x01 0x68 0x0f 0x01 0x68 0xf0 0x01 0x69 0x0f 0x01 0x69 0xf0 0x01 0x6c 0x0f 0x01>;
		};
	};

	fragment@69 {
		target = <0xffffffff>;

		__overlay__ {
			pinctrl-mt5896,bits = <0x49 0xf0 0x04 0x4d 0x0f 0x04 0x4c 0xf0 0x04 0x4c 0x0f 0x04 0x4d 0xf0 0x04 0x49 0x0f 0x04 0x50 0x0f 0x04 0x54 0xf0 0x04 0x54 0x0f 0x04 0x51 0xf0 0x04 0x51 0x0f 0x04>;
			pinctrl-mtk,pins = <0x49 0xf0 0x04 0x4d 0x0f 0x04 0x4c 0xf0 0x04 0x4c 0x0f 0x04 0x4d 0xf0 0x04 0x49 0x0f 0x04 0x50 0x0f 0x04 0x54 0xf0 0x04 0x54 0x0f 0x04 0x51 0xf0 0x04 0x51 0x0f 0x04>;
		};
	};

	fragment@70 {
		target = <0xffffffff>;

		__overlay__ {
			pinctrl-mt5896,bits = <0x54 0x0f 0x05 0x55 0xf0 0x05 0x55 0x0f 0x05 0x54 0xf0 0x05 0x58 0x0f 0x05 0x58 0xf0 0x05 0x59 0x0f 0x05 0x59 0xf0 0x05 0x5c 0x0f 0x05 0x5c 0xf0 0x05 0x5d 0x0f 0x05>;
			pinctrl-mtk,pins = <0x54 0x0f 0x05 0x55 0xf0 0x05 0x55 0x0f 0x05 0x54 0xf0 0x05 0x58 0x0f 0x05 0x58 0xf0 0x05 0x59 0x0f 0x05 0x59 0xf0 0x05 0x5c 0x0f 0x05 0x5c 0xf0 0x05 0x5d 0x0f 0x05>;
		};
	};

	fragment@71 {
		target = <0xffffffff>;

		__overlay__ {
			pinctrl-mt5896,bits = <0x4c 0x0f 0x04 0x4c 0xf0 0x04 0x4d 0x0f 0x04 0x4d 0xf0 0x04 0x49 0x0f 0x04 0x50 0x0f 0x04>;
		};
	};

	fragment@72 {
		target = <0xffffffff>;

		__overlay__ {
			pinctrl-mt5896,bits = <0x54 0xf0 0x02 0x55 0x0f 0x02 0x55 0xf0 0x02 0x58 0x0f 0x02 0x58 0xf0 0x02 0x59 0x0f 0x02>;
		};
	};

	fragment@73 {
		target = <0xffffffff>;

		__overlay__ {
			pinctrl-mt5896,bits = <0x54 0xf0 0x04 0x54 0x0f 0x04 0x51 0xf0 0x04 0x51 0x0f 0x04 0x50 0xf0 0x04 0x60 0xf0 0x04>;
		};
	};

	fragment@74 {
		target = <0xffffffff>;

		__overlay__ {
			pinctrl-mt5896,bits = <0x59 0xf0 0x02 0x5c 0x0f 0x02 0x5c 0xf0 0x02 0x5d 0x0f 0x02 0x5d 0xf0 0x02 0x60 0x0f 0x02>;
		};
	};

	fragment@75 {
		target = <0xffffffff>;

		__overlay__ {
			pinctrl-mt5896,bits = <0x55 0x0f 0x04 0x55 0xf0 0x04 0x58 0x0f 0x04 0x58 0xf0 0x04>;
		};
	};

	fragment@76 {
		target = <0xffffffff>;

		__overlay__ {
			pinctrl-mt5896,bits = <0x4d 0xf0 0x01 0x50 0x0f 0x01 0x50 0xf0 0x01 0x51 0x0f 0x01>;
		};
	};

	fragment@77 {
		target = <0xffffffff>;

		__overlay__ {
			pinctrl-mt5896,bits = <0x3d 0x0f 0x05 0x3d 0xf0 0x05 0x40 0x0f 0x05 0x40 0xf0 0x05>;
			pinctrl-mtk,pins = <0x3d 0x0f 0x05 0x3d 0xf0 0x05 0x40 0x0f 0x05 0x40 0xf0 0x05>;
		};
	};

	fragment@78 {
		target = <0xffffffff>;

		__overlay__ {
			pinctrl-mt5896,bits = <0x39 0xf0 0x03>;
			pinctrl-mtk,pins = <0x39 0xf0 0x03>;
		};
	};

	fragment@79 {
		target = <0xffffffff>;

		__overlay__ {
			pinctrl-mt5896,bits = <0x45 0xf0 0x04>;
			pinctrl-mtk,pins = <0x45 0xf0 0x04>;
		};
	};

	fragment@80 {
		target = <0xffffffff>;

		__overlay__ {
			pinctrl-mt5896,bits = <0x1c 0xf0 0x01 0x1d 0x0f 0x01 0x1d 0xf0 0x01 0x20 0x0f 0x01 0x10 0xf0 0x03 0x20 0xf0 0x02 0x21 0x0f 0x02>;
			pinctrl-mtk,pins = <0x1c 0xf0 0x01 0x1d 0x0f 0x01 0x1d 0xf0 0x01 0x20 0x0f 0x01 0x10 0xf0 0x03 0x20 0xf0 0x02 0x21 0x0f 0x02>;
		};
	};

	fragment@81 {
		target = <0xffffffff>;

		__overlay__ {
			pinctrl-mt5896,bits = <0x09 0xf0 0x01 0x0c 0x0f 0x01 0x0c 0xf0 0x01 0x0d 0x0f 0x01>;
			pinctrl-mtk,pins = <0x09 0xf0 0x01 0x0c 0x0f 0x01 0x0c 0xf0 0x01 0x0d 0x0f 0x01>;
		};
	};

	fragment@82 {
		target = <0xffffffff>;

		__overlay__ {
			pinctrl-mt5896,bits = <0x29 0xf0 0x09 0x2c 0x0f 0x09 0x2c 0xf0 0x09 0x38 0x0f 0x09>;
		};
	};

	fragment@83 {
		target = <0xffffffff>;

		__overlay__ {
			pinctrl-mt5896,bits = <0x18 0xf0 0x01 0x11 0xf0 0x01 0x19 0x0f 0x01>;
		};
	};

	fragment@84 {
		target = <0xffffffff>;

		__overlay__ {
			pinctrl-mt5896,bits = <0x1d 0xf0 0x01 0x20 0x0f 0x01 0x20 0xf0 0x01 0x21 0x0f 0x01>;
		};
	};

	fragment@85 {
		target = <0xffffffff>;

		__overlay__ {
			pinctrl-mt5896,bits = <0x88 0xf0 0x01>;
		};
	};

	fragment@86 {
		target = <0xffffffff>;

		__overlay__ {
			pinctrl-mt5896,bits = <0x89 0x0f 0x01>;
		};
	};

	fragment@87 {
		target = <0xffffffff>;

		__overlay__ {
			pinctrl-mt5896,bits = <0x88 0xf0 0x00>;
			pinctrl-mtk,pins = <0x88 0xf0 0x00>;
		};
	};

	fragment@88 {
		target = <0xffffffff>;

		__overlay__ {
			pinctrl-mt5896,bits = <0x84 0x0f 0x01>;
		};
	};

	fragment@89 {
		target = <0xffffffff>;

		__overlay__ {
			pinctrl-mt5896,bits = <0x81 0xf0 0x01>;
		};
	};

	fragment@90 {
		target = <0xffffffff>;

		__overlay__ {
			pinctrl-mt5896,bits = <0x85 0x0f 0x04 0x84 0xf0 0x04>;
			pinctrl-mtk,pins = <0x85 0x0f 0x04 0x84 0xf0 0x04>;
		};
	};

	fragment@91 {
		target = <0xffffffff>;

		__overlay__ {
			pinctrl-mt5896,bits;
			pinctrl-mtk,pins;
		};
	};

	fragment@92 {
		target = <0xffffffff>;

		__overlay__ {
			pinctrl-mt5896,bits;
			pinctrl-mtk,pins;
		};
	};

	fragment@93 {
		target = <0xffffffff>;

		__overlay__ {
			pinctrl-mt5896,bits;
			pinctrl-mtk,pins;
		};
	};

	fragment@94 {
		target = <0xffffffff>;

		__overlay__ {
			pinctrl-mt5896,bits = <0x85 0x0f 0x03 0x84 0xf0 0x03>;
		};
	};

	fragment@95 {
		target = <0xffffffff>;

		__overlay__ {
			pinctrl-mt5896,bits = <0x00 0x0f 0x04 0x00 0xf0 0x04 0x01 0x0f 0x04 0x01 0xf0 0x04 0x04 0x0f 0x04 0x05 0x0f 0x05 0x08 0x0f 0x04 0x3c 0x0f 0x07>;
			pinctrl-mtk,pins = <0x00 0x0f 0x04 0x00 0xf0 0x04 0x01 0x0f 0x04 0x01 0xf0 0x04 0x04 0x0f 0x04 0x05 0x0f 0x05 0x08 0x0f 0x04 0x3c 0x0f 0x07>;
		};
	};

	fragment@96 {
		target = <0xffffffff>;

		__overlay__ {
			pinctrl-mt5896,bits = <0x29 0xf0 0x00 0x2c 0x0f 0x00 0x30 0x0f 0x00 0x44 0xf0 0x00>;
			pinctrl-mtk,pins = <0x29 0xf0 0x00 0x2c 0x0f 0x00 0x30 0x0f 0x00 0x44 0xf0 0x00>;
		};
	};

	fragment@97 {
		target = <0xffffffff>;

		__overlay__ {
			pinctrl-mt5896,bits = <0x29 0xf0 0x07 0x2c 0x0f 0x07 0x30 0x0f 0x09 0x44 0xf0 0x08>;
			pinctrl-mtk,pins = <0x29 0xf0 0x07 0x2c 0x0f 0x07 0x30 0x0f 0x09 0x44 0xf0 0x08>;
		};
	};

	fragment@98 {
		target = <0xffffffff>;

		__overlay__ {
			pinctrl-mt5896,bits = <0x01 0x0f 0x05 0x08 0x0f 0x05 0x01 0xf0 0x05 0x00 0xf0 0x05>;
			pinctrl-mtk,pins = <0x01 0x0f 0x05 0x08 0x0f 0x05 0x01 0xf0 0x05 0x00 0xf0 0x05>;
		};
	};

	fragment@99 {
		target = <0xffffffff>;

		__overlay__ {
			pinctrl-mt5896,bits = <0x11 0x0f 0x06 0x10 0xf0 0x03 0x10 0x0f 0x03 0x14 0x0f 0x06>;
			pinctrl-mtk,pins = <0x11 0x0f 0x06 0x10 0xf0 0x03 0x10 0x0f 0x03 0x14 0x0f 0x06>;
		};
	};

	fragment@100 {
		target = <0xffffffff>;

		__overlay__ {
			pinctrl-mt5896,bits = <0x3d 0xf0 0x07 0x40 0xf0 0x07 0x40 0x0f 0x07 0x3d 0x0f 0x07>;
			pinctrl-mtk,pins = <0x3d 0xf0 0x07 0x40 0xf0 0x07 0x40 0x0f 0x07 0x3d 0x0f 0x07>;
		};
	};

	fragment@101 {
		target = <0xffffffff>;

		__overlay__ {
			pinctrl-mt5896,bits = <0x04 0x0f 0x02 0x05 0x0f 0x04 0x3c 0x0f 0x06 0x00 0x0f 0x01>;
			pinctrl-mtk,pins = <0x04 0x0f 0x02 0x05 0x0f 0x04 0x3c 0x0f 0x06 0x00 0x0f 0x01>;
		};
	};

	fragment@102 {
		target = <0xffffffff>;

		__overlay__ {
			pinctrl-mt5896,bits = <0x6d 0x0f 0x05 0x6c 0xf0 0x05 0x6d 0xf0 0x05 0x70 0x0f 0x05>;
			pinctrl-mtk,pins = <0x6d 0x0f 0x05 0x6c 0xf0 0x05 0x6d 0xf0 0x05 0x70 0x0f 0x05>;
		};
	};

	fragment@103 {
		target = <0xffffffff>;

		__overlay__ {
			pinctrl-mt5896,bits = <0x20 0x0f 0x05 0x20 0xf0 0x05 0x21 0x0f 0x05 0x1d 0xf0 0x04>;
			pinctrl-mtk,pins = <0x20 0x0f 0x05 0x20 0xf0 0x05 0x21 0x0f 0x05 0x1d 0xf0 0x04>;
		};
	};

	fragment@104 {
		target = <0xffffffff>;

		__overlay__ {
			pinctrl-mt5896,bits = <0x14 0x0f 0x04>;
			pinctrl-mtk,pins = <0x14 0x0f 0x04>;
		};
	};

	fragment@105 {
		target = <0xffffffff>;

		__overlay__ {
			pinctrl-mt5896,bits = <0x14 0x0f 0x00>;
			pinctrl-mtk,pins = <0x14 0x0f 0x00>;
		};
	};

	fragment@106 {
		target = <0xffffffff>;

		__overlay__ {
			pinctrl-mt5896,bits = <0x11 0x0f 0x03>;
			pinctrl-mtk,pins = <0x11 0x0f 0x03>;
		};
	};

	fragment@107 {
		target = <0xffffffff>;

		__overlay__ {
			pinctrl-mt5896,bits = <0x18 0xf0 0x06>;
			pinctrl-mtk,pins = <0x18 0xf0 0x06>;
		};
	};

	fragment@108 {
		target = <0xffffffff>;

		__overlay__ {
			pinctrl-mt5896,bits = <0x08 0xf0 0x01>;
			pinctrl-mtk,pins = <0x08 0xf0 0x01>;
		};
	};

	fragment@109 {
		target = <0xffffffff>;

		__overlay__ {
			pinctrl-mt5896,bits = <0x08 0xf0 0x00>;
			pinctrl-mtk,pins = <0x08 0xf0 0x00>;
		};
	};

	fragment@110 {
		target = <0xffffffff>;

		__overlay__ {
			pinctrl-mt5896,bits = <0x04 0xf0 0x04>;
			pinctrl-mtk,pins = <0x04 0xf0 0x04>;
		};
	};

	fragment@111 {
		target = <0xffffffff>;

		__overlay__ {
			pinctrl-mt5896,bits = <0x85 0xf0 0x05>;
			pinctrl-mtk,pins = <0x85 0xf0 0x05>;
		};
	};

	fragment@112 {
		target = <0xffffffff>;

		__overlay__ {
			pinctrl-mt5896,bits = <0x20 0xf0 0x04>;
			pinctrl-mtk,pins = <0x20 0xf0 0x04>;
		};
	};

	fragment@113 {
		target = <0xffffffff>;

		__overlay__ {
			pinctrl-mt5896,bits = <0x2d 0xf0 0x07>;
			pinctrl-mtk,pins = <0x2d 0xf0 0x07>;
		};
	};

	fragment@114 {
		target = <0xffffffff>;

		__overlay__ {
			pinctrl-mt5896,bits = <0x81 0xf0 0x02>;
			pinctrl-mtk,pins = <0x81 0xf0 0x02>;
		};
	};

	fragment@115 {
		target = <0xffffffff>;

		__overlay__ {
			pinctrl-mt5896,bits = <0x85 0xf0 0x03>;
			pinctrl-mtk,pins = <0x85 0xf0 0x03>;
		};
	};

	fragment@116 {
		target = <0xffffffff>;

		__overlay__ {
			pinctrl-names = "default\0hdmib_pm_uart0\0hdmic_pm_uart0";
			pinctrl-0 = <0xffffffff>;
			pinctrl-1 = <0xffffffff>;
			pinctrl-2 = <0xffffffff>;
		};
	};

	fragment@117 {
		target = <0xffffffff>;

		__overlay__ {
			pinctrl-mtk,pins = <0x40 0x0f 0x01 0x40 0xf0 0x01 0x41 0x0f 0x01>;
		};
	};

	fragment@118 {
		target = <0xffffffff>;

		__overlay__ {
			pinctrl-mt5896,bits = <0x40 0x0f 0x03 0x40 0xf0 0x03 0x41 0x0f 0x03>;
			pinctrl-mtk,pins = <0x40 0x0f 0x03 0x40 0xf0 0x03 0x41 0x0f 0x03>;
		};
	};

	fragment@119 {
		target = <0xffffffff>;

		__overlay__ {
			pinctrl-mt5896,bits = <0x40 0x0f 0x03 0x40 0xf0 0x03 0x41 0x0f 0x03>;
			pinctrl-mtk,pins = <0x40 0x0f 0x03 0x40 0xf0 0x03 0x41 0x0f 0x03>;
		};
	};

	fragment@120 {
		target = <0xffffffff>;

		__overlay__ {
			pinctrl-mt5896,bits = <0x00 0x0f 0x01 0x00 0xf0 0x01>;
			pinctrl-mtk,pins = <0x00 0x0f 0x01 0x00 0xf0 0x01>;
		};
	};

	fragment@121 {
		target = <0xffffffff>;

		__overlay__ {
			pinctrl-mt5896,bits = <0x3d 0x0f 0x05 0x3d 0xf0 0x05>;
			pinctrl-mtk,pins = <0x3d 0x0f 0x05 0x3d 0xf0 0x05>;
		};
	};

	fragment@122 {
		target = <0xffffffff>;

		__overlay__ {
			pinctrl-mt5896,bits = <0x08 0xf0 0x01 0x08 0x0f 0x01 0x09 0x0f 0x01 0x09 0xf0 0x01>;
		};
	};

	fragment@123 {
		target = <0xffffffff>;

		__overlay__ {
			pinctrl-mt5896,bits;
			pinctrl-mtk,pins;
		};
	};

	fragment@124 {
		target = <0xffffffff>;

		__overlay__ {
			pinctrl-mt5896,bits = <0x15 0xf0 0x01 0x18 0x0f 0x01>;
			pinctrl-mtk,pins = <0x15 0xf0 0x01 0x18 0x0f 0x01>;
		};
	};

	fragment@125 {
		target = <0xffffffff>;

		__overlay__ {
			pinctrl-mt5896,bits = <0x15 0x0f 0x01 0x14 0xf0 0x01>;
			pinctrl-mtk,pins = <0x15 0x0f 0x01 0x14 0xf0 0x01>;
		};
	};

	fragment@126 {
		target = <0xffffffff>;

		__overlay__ {
			pinctrl-mt5896,bits = <0x29 0x0f 0x05 0x29 0xf0 0x05>;
			pinctrl-mtk,pins = <0x29 0x0f 0x05 0x29 0xf0 0x05>;
		};
	};

	fragment@127 {
		target = <0xffffffff>;

		__overlay__ {
			pinctrl-mt5896,bits = <0x2d 0x0f 0x04 0x2d 0xf0 0x04>;
			pinctrl-mtk,pins = <0x2d 0x0f 0x04 0x2d 0xf0 0x04>;
		};
	};

	fragment@128 {
		target = <0xffffffff>;

		__overlay__ {
			pinctrl-mt5896,bits = <0x01 0xf0 0x01>;
		};
	};

	fragment@129 {
		target = <0xffffffff>;

		__overlay__ {
			pinctrl-mt5896,bits = <0x20 0x0f 0x01>;
		};
	};

	fragment@130 {
		target = <0xffffffff>;

		__overlay__ {
			pinctrl-mt5896,bits = <0x10 0xf0 0x03>;
		};
	};

	fragment@131 {
		target = <0xffffffff>;

		__overlay__ {
			pinctrl-mt5896,bits = <0x4c 0x0f 0x01 0x4d 0xf0 0x01 0x49 0x0f 0x01 0x50 0x0f 0x01 0x51 0x0f 0x01 0x51 0xf0 0x01 0x54 0x0f 0x01 0x54 0xf0 0x01 0x50 0xf0 0x01 0x55 0x0f 0x01 0x55 0xf0 0x01 0x49 0xf0 0x01 0x4c 0xf0 0x01 0x4d 0x0f 0x01>;
			pinctrl-mtk,pins = <0x4c 0x0f 0x01 0x4d 0xf0 0x01 0x49 0x0f 0x01 0x50 0x0f 0x01 0x51 0x0f 0x01 0x51 0xf0 0x01 0x54 0x0f 0x01 0x54 0xf0 0x01 0x50 0xf0 0x01 0x55 0x0f 0x01 0x55 0xf0 0x01 0x49 0xf0 0x01 0x4c 0xf0 0x01 0x4d 0x0f 0x01>;
		};
	};

	fragment@132 {
		target = <0xffffffff>;

		__overlay__ {
			pinctrl-mt5896,bits = <0x4c 0x0f 0x01 0x4d 0xf0 0x01 0x49 0x0f 0x01 0x50 0x0f 0x01 0x51 0x0f 0x01 0x51 0xf0 0x01 0x54 0x0f 0x01 0x54 0xf0 0x01 0x50 0xf0 0x01 0x55 0x0f 0x01 0x55 0xf0 0x01 0x49 0xf0 0x01 0x4c 0xf0 0x01 0x4d 0x0f 0x01 0x48 0x0f 0x01 0x48 0xf0 0x01 0x58 0x0f 0x01 0x58 0xf0 0x01>;
			pinctrl-mtk,pins = <0x4c 0x0f 0x01 0x4d 0xf0 0x01 0x49 0x0f 0x01 0x50 0x0f 0x01 0x51 0x0f 0x01 0x51 0xf0 0x01 0x54 0x0f 0x01 0x54 0xf0 0x01 0x50 0xf0 0x01 0x55 0x0f 0x01 0x55 0xf0 0x01 0x49 0xf0 0x01 0x4c 0xf0 0x01 0x4d 0x0f 0x01 0x48 0x0f 0x01 0x48 0xf0 0x01 0x58 0x0f 0x01 0x58 0xf0 0x01>;
		};
	};

	fragment@133 {
		target = <0xffffffff>;

		__overlay__ {
		};
	};

	fragment@134 {
		target = <0xffffffff>;

		__overlay__ {
			pinctrl-mt5896,pins = <0x248 0x00>;
			pinctrl-mt5896,bias-pulldown = <0x00 0x28 0x00 0x28>;
			pinctrl-mt5896,bias-pullup = <0x00 0x20 0x00 0x20>;
			pinctrl-mt5896,drive-strength = <0x07 0x01>;
		};
	};

	fragment@135 {
		target = <0xffffffff>;

		__overlay__ {
			pinctrl-mt5896,pins = <0x250 0x00>;
			pinctrl-mt5896,bias-pulldown = <0x00 0x28 0x00 0x28>;
			pinctrl-mt5896,bias-pullup = <0x00 0x20 0x00 0x20>;
			pinctrl-mt5896,drive-strength = <0x07 0x01>;
		};
	};

	fragment@136 {
		target = <0xffffffff>;

		__overlay__ {
			pinctrl-mt5896,pins = <0x268 0x00 0x270 0x00>;
			pinctrl-mt5896,drive-strength = <0x07 0x03>;
		};
	};

	fragment@137 {
		target = <0xffffffff>;

		__overlay__ {
			pinctrl-mt5896,pins = <0x260 0x00>;
			pinctrl-mt5896,drive-strength = <0x07 0x04>;
		};
	};

	fragment@138 {
		target = <0xffffffff>;

		__overlay__ {
		};
	};

	fragment@139 {
		target = <0xffffffff>;

		__overlay__ {
			pinctrl-mt5896,pins = <0x260 0x00 0x278 0x00 0x250 0x00 0x268 0x00 0x270 0x00>;
			pinctrl-mt5896,drive-strength = <0x07 0x05>;
			pinctrl-mtk,pins = <0x260 0x07 0x05 0x278 0x07 0x05 0x250 0x07 0x05 0x268 0x07 0x05 0x270 0x07 0x05>;
		};
	};

	fragment@140 {
		target = <0xffffffff>;

		__overlay__ {
			pinctrl-mt5896,pins = <0x258 0x00>;
			pinctrl-mt5896,drive-strength = <0x07 0x03>;
			pinctrl-mtk,pins = <0x258 0x07 0x03>;
		};
	};

	fragment@141 {
		target = <0xffffffff>;

		__overlay__ {
			pinctrl-mt5896,pins = <0x10 0x00 0x40 0x00 0x18 0x00 0x08 0x00>;
			pinctrl-mt5896,drive-strength = <0x07 0x07>;
			pinctrl-mtk,pins = <0x10 0x07 0x07 0x40 0x07 0x07 0x18 0x07 0x07 0x08 0x07 0x07>;
		};
	};

	fragment@142 {
		target = <0xffffffff>;

		__overlay__ {
			pinctrl-mt5896,pins = <0x90 0x00 0x88 0x00 0x80 0x00 0xa0 0x00>;
			pinctrl-mt5896,drive-strength = <0x07 0x07>;
			pinctrl-mtk,pins = <0x90 0x07 0x07 0x88 0x07 0x07 0x80 0x07 0x07 0xa0 0x07 0x07>;
		};
	};

	fragment@143 {
		target = <0xffffffff>;

		__overlay__ {
			pinctrl-mt5896,pins = <0x1f8 0x00 0x208 0x00 0x200 0x00 0x1f0 0x00>;
			pinctrl-mt5896,drive-strength = <0x07 0x07>;
			pinctrl-mtk,pins = <0x1f8 0x07 0x07 0x208 0x07 0x07 0x200 0x07 0x07 0x1f0 0x07 0x07>;
		};
	};

	fragment@144 {
		target = <0xffffffff>;

		__overlay__ {
			pinctrl-mt5896,pins = <0x20 0x00 0x30 0x00 0x1e0 0x00 0x00 0x00>;
			pinctrl-mt5896,drive-strength = <0x07 0x07>;
			pinctrl-mtk,pins = <0x20 0x07 0x07 0x30 0x07 0x07 0x1e0 0x07 0x07 0x00 0x07 0x07>;
		};
	};

	fragment@145 {
		target = <0xffffffff>;

		__overlay__ {
			pinctrl-mt5896,pins = <0x370 0x00 0x368 0x00 0x378 0x00 0x380 0x00>;
			pinctrl-mt5896,drive-strength = <0x07 0x07>;
			pinctrl-mtk,pins = <0x370 0x07 0x07 0x368 0x07 0x07 0x378 0x07 0x07 0x380 0x07 0x07>;
		};
	};

	fragment@146 {
		target = <0xffffffff>;

		__overlay__ {
			pinctrl-mt5896,pins = <0x100 0x00 0x108 0x00 0x110 0x00 0xf8 0x00>;
			pinctrl-mt5896,drive-strength = <0x07 0x07>;
			pinctrl-mtk,pins = <0x100 0x07 0x07 0x108 0x07 0x07 0x110 0x07 0x07 0xf8 0x07 0x07>;
		};
	};

	fragment@147 {
		target = <0xffffffff>;

		__overlay__ {
			pinctrl-mt5896,bits = <0x45 0xf0 0x00>;
			pinctrl-mtk,pins = <0x45 0xf0 0x00>;
		};
	};

	fragment@148 {
		target = <0xffffffff>;

		__overlay__ {
			pinctrl-mt5896,bits = <0x45 0xf0 0x01>;
			pinctrl-mtk,pins = <0x45 0xf0 0x01>;
		};
	};

	fragment@149 {
		target = <0xffffffff>;

		__overlay__ {
			pinctrl-mt5896,pins = <0x238 0x00>;
			pinctrl-mtk,pins = <0x238 0x07 0x07>;
			pinctrl-mt5896,drive-strength = <0x07 0x01>;
		};
	};

	fragment@150 {
		target = <0xffffffff>;

		__overlay__ {
			pinctrl-mt5896,pins = <0x238 0x00>;
			pinctrl-mtk,pins = <0x238 0x07 0x07>;
			pinctrl-mt5896,drive-strength = <0x07 0x03>;
		};
	};

	__fixups__ {
		mtk_pqu = "/fragment@0:target:0";
		digmux_uart4_pmux = "/fragment@0/__overlay__:pinctrl-0:0\0/fragment@94:target:0";
		pmu_rproc = "/fragment@1:target:0\0/fragment@40:target:0";
		dmic_record_pmux = "/fragment@1/__overlay__:pinctrl-0:0\0/fragment@2/__overlay__:pinctrl-0:0\0/fragment@117:target:0";
		pm_uart0_pmux = "/fragment@1/__overlay__:pinctrl-0:4\0/fragment@2/__overlay__:pinctrl-0:4\0/fragment@124:target:0";
		vad_rproc = "/fragment@2:target:0\0/fragment@42:target:0";
		mediatek_drm_tv_kms = "/fragment@3:target:0";
		ldc_tmon_gpio_pmux = "/fragment@3/__overlay__:pinctrl-0:0\0/fragment@4/__overlay__:pinctrl-0:0\0/fragment@96:target:0";
		ldc_tmon_pmux = "/fragment@3/__overlay__:pinctrl-1:0\0/fragment@4/__overlay__:pinctrl-1:0\0/fragment@97:target:0";
		ldc_in_out_pmux = "/fragment@3/__overlay__:pinctrl-2:0\0/fragment@4/__overlay__:pinctrl-2:0\0/fragment@95:target:0";
		vsync_like4_gpio_pmux = "/fragment@3/__overlay__:pinctrl-3:0\0/fragment@109:target:0";
		vsync_like4_pmux = "/fragment@3/__overlay__:pinctrl-4:0\0/fragment@108:target:0";
		mediatek_ldm = "/fragment@4:target:0";
		gpio0 = "/fragment@4/__overlay__:gpios:0\0/fragment@10/__overlay__:vbus-gpios:0\0/fragment@10/__overlay__:vbus-gpios:12\0/fragment@10/__overlay__:vbus-gpios:24\0/fragment@10/__overlay__:ocp-gpios:0\0/fragment@10/__overlay__:ocp-gpios:12\0/fragment@10/__overlay__:ocp-gpios:24\0/fragment@37:target:0\0/fragment@45/__overlay__:vcc-gpios:0";
		mtk_sound_soc = "/fragment@5:target:0\0/fragment@7:target:0";
		i2s_out_pmux = "/fragment@5/__overlay__:pinctrl-0:0\0/fragment@6/__overlay__:pinctrl-0:0\0/fragment@81:target:0";
		i2s_in_pmux = "/fragment@5/__overlay__:pinctrl-0:4\0/fragment@6/__overlay__:pinctrl-0:4\0/fragment@83:target:0";
		i2s_in2_pmux = "/fragment@5/__overlay__:pinctrl-0:8\0/fragment@6/__overlay__:pinctrl-0:8\0/fragment@84:target:0";
		spdif_out_pmux = "/fragment@5/__overlay__:pinctrl-0:12\0/fragment@6/__overlay__:pinctrl-0:12\0/fragment@88:target:0";
		spdif_in_pmux = "/fragment@5/__overlay__:pinctrl-0:16\0/fragment@6/__overlay__:pinctrl-0:16\0/fragment@89:target:0";
		mtk_tv_machine = "/fragment@6:target:0";
		u3phy0 = "/fragment@8:target:0";
		u3phy1 = "/fragment@9:target:0";
		usb_host0 = "/fragment@10:target:0\0/fragment@12:target:0";
		usb_host1 = "/fragment@11:target:0";
		pm_gpio0 = "/fragment@11/__overlay__:vbus-gpios:0\0/fragment@36:target:0\0/fragment@38/__overlay__/led0:gpios:0\0/fragment@38/__overlay__/led1:gpios:0\0/fragment@50/__overlay__:extcon-gpios:0";
		i2c0 = "/fragment@13:target:0\0/fragment@20:target:0";
		i2c0_pmux = "/fragment@13/__overlay__:pinctrl-0:0\0/fragment@55:target:0";
		i2c1 = "/fragment@14:target:0\0/fragment@21:target:0";
		i2c1_pmux = "/fragment@14/__overlay__:pinctrl-0:0\0/fragment@56:target:0";
		i2c2 = "/fragment@15:target:0\0/fragment@22:target:0";
		i2c2_pmux = "/fragment@15/__overlay__:pinctrl-0:0\0/fragment@57:target:0";
		i2c3 = "/fragment@16:target:0\0/fragment@23:target:0";
		i2c3_pmux = "/fragment@16/__overlay__:pinctrl-0:0\0/fragment@58:target:0";
		i2c4 = "/fragment@17:target:0";
		pm_i2c0 = "/fragment@18:target:0";
		pm_i2c1 = "/fragment@19:target:0\0/fragment@24:target:0\0/fragment@43:target:0";
		pm_i2c1_pmux = "/fragment@19/__overlay__:pinctrl-0:0\0/fragment@121:target:0";
		uart0 = "/fragment@25:target:0\0/fragment@31:target:0";
		uart1 = "/fragment@26:target:0\0/fragment@32:target:0";
		uart2 = "/fragment@27:target:0\0/fragment@33:target:0";
		uart3 = "/fragment@28:target:0\0/fragment@34:target:0";
		uart4 = "/fragment@29:target:0";
		uart5 = "/fragment@30:target:0";
		hw_info = "/fragment@35:target:0";
		gpio_front_led = "/fragment@38:target:0";
		gmac = "/fragment@39:target:0";
		pmu_ini = "/fragment@41:target:0";
		pkg_lane_order = "/fragment@44:target:0";
		video_out = "/fragment@45:target:0\0/fragment@46:target:0";
		scanpwm1 = "/fragment@47:target:0\0/fragment@52:target:0";
		scanpwm0 = "/fragment@48:target:0";
		panel_cus_setting = "/fragment@49:target:0";
		extcon_gpio = "/fragment@50:target:0";
		pwm = "/fragment@51:target:0";
		panel_bri4_pmux = "/fragment@51/__overlay__:pinctrl-0:0\0/fragment@52/__overlay__:pinctrl-0:0\0/fragment@78:target:0";
		serflash = "/fragment@53:target:0";
		pm_spi_pmux = "/fragment@53/__overlay__:pinctrl-0:0\0/fragment@122:target:0";
		pinctrl = "/fragment@54:target:0";
		mspi_frc_pmux = "/fragment@54/__overlay__:pinctrl-0:0\0/fragment@77:target:0";
		ext_ts_demod_pmux = "/fragment@59:target:0";
		ext1_ts_demod_pmux = "/fragment@60:target:0";
		ext2_ts_demod_pmux = "/fragment@61:target:0";
		ts_cilink_tx_rx_demod0_pmux_shared = "/fragment@62:target:0";
		ts_cilink_tx_rx_demod0_pmux = "/fragment@63:target:0";
		ts_cilink_tx_rx_demod1_pmux_shared = "/fragment@64:target:0";
		ts_cilink_tx_rx_demod1_pmux = "/fragment@65:target:0";
		ts_cilink_tx_rx_clk_pmux_shared = "/fragment@66:target:0";
		ts_cilink_tx_rx_clk_pmux = "/fragment@67:target:0";
		ext_ts_para_demod_pmux = "/fragment@68:target:0";
		ts1_para_out_pmux_shared = "/fragment@69:target:0";
		ts1_para_out_pmux = "/fragment@70:target:0";
		smart_card1_pmux_shared = "/fragment@71:target:0";
		smart_card1_pmux = "/fragment@72:target:0";
		smart_card2_pmux_shared = "/fragment@73:target:0";
		smart_card2_pmux = "/fragment@74:target:0";
		mspi_cilink_pmux_shared = "/fragment@75:target:0";
		mspi_cilink_pmux = "/fragment@76:target:0";
		panel_bri3_pmux = "/fragment@79:target:0";
		pm_led_pwm_pmux = "/fragment@80:target:0";
		i2s_out2_pmux = "/fragment@82:target:0";
		diseqc_out_pmux = "/fragment@85:target:0";
		diseqc_in_pmux = "/fragment@86:target:0";
		diseqc_nonpm_out_pmux = "/fragment@87:target:0";
		fuart0_pmux = "/fragment@90:target:0";
		uart0_pmux = "/fragment@91:target:0";
		uart1_pmux = "/fragment@92:target:0";
		uart2_pmux = "/fragment@93:target:0";
		ld0_spi_pmux = "/fragment@98:target:0";
		ld1_spi_pmux = "/fragment@99:target:0";
		ld2_spi_pmux = "/fragment@100:target:0";
		ld3_spi_pmux = "/fragment@101:target:0";
		ld4_spi_pmux = "/fragment@102:target:0";
		ld7_spi_pmux = "/fragment@103:target:0";
		vsync_like1_pmux = "/fragment@104:target:0";
		vsync_like1_gpio_pmux = "/fragment@105:target:0";
		vsync_like2_pmux = "/fragment@106:target:0";
		vsync_like3_pmux = "/fragment@107:target:0";
		vsync_like5_pmux = "/fragment@110:target:0";
		vsync_like6_pmux = "/fragment@111:target:0";
		hsync_like1_pmux = "/fragment@112:target:0";
		hsync_like2_pmux = "/fragment@113:target:0";
		hsync_like3_pmux = "/fragment@114:target:0";
		hsync_like4_pmux = "/fragment@115:target:0";
		pm_pinctrl = "/fragment@116:target:0";
		pm_i2c0_pmux = "/fragment@116/__overlay__:pinctrl-0:0\0/fragment@120:target:0";
		hdmib_pm_uart0_pmux = "/fragment@116/__overlay__:pinctrl-1:0\0/fragment@126:target:0";
		hdmic_pm_uart0_pmux = "/fragment@116/__overlay__:pinctrl-2:0\0/fragment@127:target:0";
		dmic_record_i2s_in_pmux = "/fragment@118:target:0";
		dmic_record_i2s_tdm_in_pmux = "/fragment@119:target:0";
		pm_fuart0_pmux = "/fragment@123:target:0";
		pm_uart1_pmux = "/fragment@125:target:0";
		ir_tx_pmux = "/fragment@128:target:0";
		fan_pwm_pmux = "/fragment@129:target:0";
		dmic_google_led_pmux = "/fragment@130:target:0";
		rgmii_pmux = "/fragment@131:target:0";
		rgmii_fpga_haps_pmux = "/fragment@132:target:0";
		pinconf = "/fragment@133:target:0";
		i2c0_sda0_pcfg = "/fragment@134:target:0";
		i2c0_scl0_pcfg = "/fragment@135:target:0";
		ts_cilink_tx_demod0_pcfg_shared = "/fragment@136:target:0";
		ts_cilink_tx_clk_pcfg_shared = "/fragment@137:target:0";
		pm_pinconf = "/fragment@138:target:0";
		rgmii_tx_pcfg = "/fragment@139:target:0";
		rgmii_tx_ext1_pcfg = "/fragment@140:target:0";
		ld0_spi_pcfg = "/fragment@141:target:0";
		ld1_spi_pcfg = "/fragment@142:target:0";
		ld2_spi_pcfg = "/fragment@143:target:0";
		ld3_spi_pcfg = "/fragment@144:target:0";
		ld4_spi_pcfg = "/fragment@145:target:0";
		ld7_spi_pcfg = "/fragment@146:target:0";
		gpio_func0_pmux = "/fragment@147:target:0";
		gpio_func1_pmux = "/fragment@148:target:0";
		gpio_func0_pcfg = "/fragment@149:target:0";
		gpio_func1_pcfg = "/fragment@150:target:0";
	};
};
