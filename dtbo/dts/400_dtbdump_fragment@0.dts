/dts-v1/;

/ {

	fragment@0 {
		target = <0xffffffff>;

		__overlay__ {
			dtbo-name-Sony-pqu-PanelDet-PanelID = "pqu_Sony_panel_det_pid_lcd.dtbo";
		};
	};

	fragment@1 {
		target = <0xffffffff>;

		__overlay__ {
			dtbo-name-Sony-pqu-bcm = "pqu_Sony_bcm_pwm_gl.dtbo";
		};
	};

	__fixups__ {
		mtk_pqu = "/fragment@0:target:0\0/fragment@1:target:0";
	};
};
