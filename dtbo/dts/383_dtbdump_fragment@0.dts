/dts-v1/;

/ {

	fragment@0 {
		target = <0xffffffff>;

		__overlay__ {
			vritual_fe_id = <0x00>;
			vritual_fe_num = <0x01>;
			cfm_group = <0xffffffff>;
		};
	};

	__fixups__ {
		mtk_cfm = "/fragment@0:target:0";
		cfm_node1 = "/fragment@0/__overlay__:cfm_group:0";
	};
};
