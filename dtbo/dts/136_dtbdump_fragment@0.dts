/dts-v1/;

/ {

	fragment@0 {
		target = <0xffffffff>;

		__overlay__ {

			sony_paneldet {
				panel_id = "YDDO007UND0301";
				enable-testpattern-control;
				testpattern-control-i2c-param = <0x02 0x30 0x12 0x02 0x00 0x01>;
				phandle = <0x01>;
			};
		};
	};

	fragment@1 {
		target = <0xffffffff>;

		__overlay__ {

			sony_panel {
				panel_id = "YDDO007UND0301";
				panelAvail;
				inch_size = "55";
				enable-testpattern-control;
				testpattern-control-i2c-param = <0x02 0x30 0x12 0x02 0x00 0x01>;
				phandle = <0x02>;

				oled_maintenance_info {
					compatible = "sony,panel_refresh";
					keys = "maintenance_support.true\0maintenance_sequence_type.SDC_TCON_SEQUENCE\0cooling_time_minutes.1\0cooling_time_minutes_for_retry.5\0cooling_temp_th_low.10\0cooling_temp_th_high.48";
				};
			};

			sony_backlight {
				panelAvail;
				phandle = <0x03>;
			};
		};
	};

	fragment@2 {
		target = <0xffffffff>;

		__overlay__ {

			sony_display_extension {
				phandle = <0x04>;

				sony_be_out_format_timing_48Hz {
					width = <0xf00>;
					height = <0x870>;
					framerate = <0xbb80>;
					total_h_size = <0x10b0>;
					total_v_size = <0xb50>;
					h_start = <0x170>;
					v_start = <0x44>;
					actHSize = <0xf00>;
					actVSize = <0x870>;
					vsWidth = <0x01>;
					hsWidth = <0x04>;
				};

				sony_be_out_format_timing_50Hz {
					width = <0xf00>;
					height = <0x870>;
					framerate = <0xc350>;
					total_h_size = <0x10b0>;
					total_v_size = <0xadc>;
					h_start = <0x170>;
					v_start = <0x44>;
					actHSize = <0xf00>;
					actVSize = <0x870>;
					vsWidth = <0x01>;
					hsWidth = <0x04>;
				};

				sony_be_out_format_timing_60Hz {
					width = <0xf00>;
					height = <0x870>;
					framerate = <0xea60>;
					total_h_size = <0x10b0>;
					total_v_size = <0x90c>;
					h_start = <0x170>;
					v_start = <0x44>;
					actHSize = <0xf00>;
					actVSize = <0x870>;
					vsWidth = <0x01>;
					hsWidth = <0x04>;
				};

				sony_be_out_format_timing_100Hz {
					width = <0xf00>;
					height = <0x870>;
					framerate = <0x186a0>;
					total_h_size = <0x10b0>;
					total_v_size = <0xadc>;
					h_start = <0x170>;
					v_start = <0x44>;
					actHSize = <0xf00>;
					actVSize = <0x870>;
					vsWidth = <0x01>;
					hsWidth = <0x04>;
				};

				sony_be_out_format_timing_120Hz {
					width = <0xf00>;
					height = <0x870>;
					framerate = <0x1d4c0>;
					total_h_size = <0x10b0>;
					total_v_size = <0x90c>;
					h_start = <0x170>;
					v_start = <0x44>;
					actHSize = <0xf00>;
					actVSize = <0x870>;
					vsWidth = <0x01>;
					hsWidth = <0x04>;
				};
			};
		};
	};

	__symbols__ {
		sony_paneldet = "/fragment@0/__overlay__/sony_paneldet";
		sony_pnl_pwr = "/fragment@1/__overlay__/sony_panel";
		sony_bl_pwr = "/fragment@1/__overlay__/sony_backlight";
		sony_display_extension = "/fragment@2/__overlay__/sony_display_extension";
	};

	__fixups__ {
		odm = "/fragment@0:target:0\0/fragment@1:target:0\0/fragment@2:target:0";
	};
};
