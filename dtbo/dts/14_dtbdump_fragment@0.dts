/dts-v1/;

/ {

	fragment@0 {
		target = <0xffffffff>;

		__overlay__ {

			ir {
				key = <0x01 0x00 0x00 0x80 0x7f 0x00 0x46 0x00 0x74 0x00 0x01 0x00 0x00 0x80 0x7f 0x00 0x03 0x00 0x68 0x00 0x01 0x00 0x00 0x80 0x7f 0x00 0x17 0x00 0x66 0x00 0x10 0x00 0x00 0x00 0x10 0x00 0x16 0x00 0x74 0x00 0x0e 0x00 0x00 0x00 0x01 0x00 0x15 0x00 0x74 0x00 0x10 0x00 0x00 0x00 0x10 0x00 0x6b 0x00 0x68 0x00 0x10 0x00 0x00 0x00 0x10 0x00 0x1d 0x00 0x66 0x00 0x01 0x00 0x00 0x88 0x77 0x00 0x21 0x00 0x74 0x00 0x01 0x00 0x00 0x88 0x77 0x00 0x64 0x00 0xbe 0x00 0x01 0x00 0x00 0x88 0x77 0x00 0x63 0x00 0xbb 0x00 0x01 0x00 0x00 0x80 0x7f 0x00 0x64 0x00 0xbe 0x00 0x01 0x00 0x00 0x80 0x7f 0x00 0x10 0x01 0x8b 0x00 0x01 0x00 0x00 0x80 0x7f 0x00 0x42 0x00 0x8a 0x00 0x00 0x00 0x00 0x00 0x00 0x00 0x00 0x00 0x00 0x00 0x00 0x00 0x00 0x00 0x00 0x00 0x00 0x00 0x00 0x00 0x00 0x00 0x00 0x00 0x00 0x00 0x00 0x00 0x00 0x00>;
			};

			sar {
				wakeup-ch = <0x01>;
				wakeup-lb = <0xff>;
				wake-adc = <0x05 0x3ff 0x3ff 0x3ff 0x3ff>;
				upgrade-ch = <0x01>;
				upgrade-lb = <0x00>;
				upgrade-adc = <0x3ff 0x3ff 0x3ff 0x3ff 0x3ff>;
			};
		};
	};

	__fixups__ {
		pmu_ini = "/fragment@0:target:0";
	};
};
