/dts-v1/;

/ {

	fragment@0 {
		target = <0xffffffff>;

		__overlay__ {
			audio-codec = <0x01>;
			codec-dai-name = "sony-damp-amplifier";
			audio-routing = "I2S0\0SPEAKER_PLAYBACK\0DAC0\0HEADPHONE_PLAYBACK\0DAC1\0LINEOUT_PLAYBACK";
		};
	};

	fragment@1 {
		target = <0xffffffff>;

		__overlay__ {

			sony_damp {
				status = "okay";
				ampmute-gpios = <0xffffffff 0x05 0x01>;
				ampreset-gpios = <0xffffffff 0x0a 0x01>;
				headphonemute-gpios = <0xffffffff 0x45 0x01>;
				amperrdet-gpios = <0xffffffff 0x2f 0x01>;
				compatible = "sony,tas5782";
				damp = <0x02 0x03 0x04>;
				phandle = <0x01>;
			};
		};
	};

	fragment@2 {
		target = <0xffffffff>;

		__overlay__ {

			tas5782_amp@48 {
				compatible = "sony,tas5782_i2c";
				reg = <0x48>;
				status = "okay";
				phandle = <0x02>;
			};

			tas5782_amp@49 {
				compatible = "sony,tas5782_i2c";
				reg = <0x49>;
				status = "okay";
				phandle = <0x03>;
			};

			tas5782_amp@4a {
				compatible = "sony,tas5782_i2c";
				reg = <0x4a>;
				status = "okay";
				phandle = <0x04>;
			};
		};
	};

	__symbols__ {
		sony_damp = "/fragment@1/__overlay__/sony_damp";
		tas5782_0 = "/fragment@2/__overlay__/tas5782_amp@48";
		tas5782_1 = "/fragment@2/__overlay__/tas5782_amp@49";
		tas5782_2 = "/fragment@2/__overlay__/tas5782_amp@4a";
	};

	__fixups__ {
		mtk_sound_machine = "/fragment@0:target:0";
		odm = "/fragment@1:target:0";
		pm_gpio0 = "/fragment@1/__overlay__/sony_damp:ampmute-gpios:0\0/fragment@1/__overlay__/sony_damp:ampreset-gpios:0";
		gpio0 = "/fragment@1/__overlay__/sony_damp:headphonemute-gpios:0\0/fragment@1/__overlay__/sony_damp:amperrdet-gpios:0";
		i2c1 = "/fragment@2:target:0";
	};

	__local_fixups__ {

		fragment@0 {

			__overlay__ {
				audio-codec = <0x00>;
			};
		};

		fragment@1 {

			__overlay__ {

				sony_damp {
					damp = <0x00 0x04 0x08>;
				};
			};
		};
	};
};
