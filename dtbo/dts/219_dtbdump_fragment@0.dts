/dts-v1/;

/ {

	fragment@0 {
		target = <0xffffffff>;

		__overlay__ {
			audio-codec = <0x01>;
		};
	};

	fragment@1 {
		target = <0xffffffff>;

		__overlay__ {

			damp_selector {
				compatible = "sony,damp_selector";
				status = "okay";
				ampreset-gpios = <0xffffffff 0x0a 0x01>;
				ampmute-gpios = <0xffffffff 0x05 0x01>;
				phandle = <0x01>;
			};
		};
	};

	fragment@2 {
		target = <0xffffffff>;

		__overlay__ {

			fdr {
				compatible = "sony,fdr";
				wled-pwm-device-num = <0x01>;
				wled-pwm-ch = <0x03>;
				phandle = <0x02>;
			};
		};
	};

	__symbols__ {
		damp_selector = "/fragment@1/__overlay__/damp_selector";
		fdr = "/fragment@2/__overlay__/fdr";
	};

	__fixups__ {
		mtk_sound_soc = "/fragment@0:target:0";
		odm = "/fragment@1:target:0\0/fragment@2:target:0";
		pm_gpio0 = "/fragment@1/__overlay__/damp_selector:ampreset-gpios:0\0/fragment@1/__overlay__/damp_selector:ampmute-gpios:0";
	};

	__local_fixups__ {

		fragment@0 {

			__overlay__ {
				audio-codec = <0x00>;
			};
		};
	};
};
