/dts-v1/;

/ {

	fragment@0 {
		target = <0xffffffff>;

		__overlay__ {

			sony_paneldet {
				isBE = "None";
				phandle = <0x01>;
			};
		};
	};

	fragment@1 {
		target = <0xffffffff>;

		__overlay__ {

			sony_display_extension {
				be_type = <0x00>;
				phandle = <0x02>;
			};
		};
	};

	__symbols__ {
		sony_paneldet = "/fragment@0/__overlay__/sony_paneldet";
		sony_display_extension = "/fragment@1/__overlay__/sony_display_extension";
	};

	__fixups__ {
		odm = "/fragment@0:target:0\0/fragment@1:target:0";
	};
};
