/dts-v1/;

/ {

	fragment@0 {
		target = <0xffffffff>;

		__overlay__ {

			lm75@4A {
				compatible = "nxp,pct2075";
				reg = <0x4a>;
				status = "okay";
				phandle = <0x01>;
			};
		};
	};

	__symbols__ {
		lm75_ambient_nxp = "/fragment@0/__overlay__/lm75@4A";
	};

	__fixups__ {
		i2c0 = "/fragment@0:target:0";
	};
};
