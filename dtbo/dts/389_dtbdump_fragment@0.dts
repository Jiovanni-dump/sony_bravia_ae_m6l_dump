/dts-v1/;

/ {

	fragment@0 {
		target = <0xffffffff>;

		__overlay__ {
			dtbo-name-Sony-oled-ip = "pqu_Sony_oled_ip_partially_enable.dtbo";
		};
	};

	__fixups__ {
		mtk_pqu = "/fragment@0:target:0";
	};
};
