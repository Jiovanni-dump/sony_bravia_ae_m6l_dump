/dts-v1/;

/ {

	fragment@0 {
		target = <0xffffffff>;

		__overlay__ {
			status = "okay";

			spidev@1 {
				status = "okay";
				pinctrl-names = "default";
				pinctrl-0 = <0xffffffff>;
			};
		};
	};

	fragment@1 {
		target = <0xffffffff>;

		__overlay__ {
			pinctrl-mt5896,bits = <0x51 0xf0 0x01>;
		};
	};

	__fixups__ {
		mspi_ci = "/fragment@0:target:0";
		ci_pmux = "/fragment@0/__overlay__/spidev@1:pinctrl-0:0\0/fragment@1:target:0";
	};
};
