/dts-v1/;

/ {

	fragment@0 {
		target = <0xffffffff>;

		__overlay__ {
			status = "okay";

			spidev@1 {
				status = "okay";
				pinctrl-names = "default";
				pinctrl-0 = <0xffffffff 0xffffffff>;
			};
		};
	};

	fragment@1 {
		target = <0xffffffff>;

		__overlay__ {
			pinctrl-mt5896,bits = <0x51 0xf0 0x01>;
		};
	};

	fragment@2 {
		target = <0xffffffff>;

		__overlay__ {
			pinctrl-mt5896,bits = <0x61 0x0f 0x04 0x60 0xf0 0x00>;
		};
	};

	fragment@3 {
		target = <0xffffffff>;

		__overlay__ {
			pinctrl-mt5896,pins = <0x2b0 0x00>;
			pinctrl-mt5896,drive-strength = <0x07 0x04>;
		};
	};

	__fixups__ {
		mspi_ci = "/fragment@0:target:0";
		ci_pmux = "/fragment@0/__overlay__/spidev@1:pinctrl-0:0\0/fragment@1:target:0";
		ci_pmux_shared = "/fragment@0/__overlay__/spidev@1:pinctrl-0:4\0/fragment@2:target:0";
		spi_clk_pcfg_shared = "/fragment@3:target:0";
	};
};
