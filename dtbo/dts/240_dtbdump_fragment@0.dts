/dts-v1/;

/ {

	fragment@0 {
		target = <0xffffffff>;

		__overlay__ {
			vritual_fe_id = <0x00>;
			vritual_fe_num = <0x01>;
			cfm_group = <0x01>;

			cfm_node2 {
				phandle = <0x01>;
			};
		};
	};

	__symbols__ {
		cfm_node2 = "/fragment@0/__overlay__/cfm_node2";
	};

	__fixups__ {
		mtk_cfm = "/fragment@0:target:0";
	};

	__local_fixups__ {

		fragment@0 {

			__overlay__ {
				cfm_group = <0x00>;
			};
		};
	};
};
