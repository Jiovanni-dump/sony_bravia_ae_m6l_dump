/dts-v1/;

/ {

	fragment@0 {
		target = <0xffffffff>;

		__overlay__ {
			audio-codec = <0x01>;
			codec-dai-name = "sony-damp-amplifier";
			audio-routing = "I2S0\0SPEAKER_PLAYBACK\0DAC0\0HEADPHONE_PLAYBACK\0DAC1\0LINEOUT_PLAYBACK";
		};
	};

	fragment@1 {
		target = <0xffffffff>;

		__overlay__ {

			sony_damp {
				status = "okay";
				ampmute-gpios = <0xffffffff 0x05 0x01>;
				ampreset-gpios = <0xffffffff 0x0a 0x01>;
				headphonemute-gpios = <0xffffffff 0x45 0x01>;
				amperrdet-gpios = <0xffffffff 0x2f 0x01>;
				compatible = "sony,rt9120s";
				damp = <0x02 0x03>;
				phandle = <0x01>;
			};
		};
	};

	fragment@2 {
		target = <0xffffffff>;

		__overlay__ {

			rt9120s_amp@18 {
				compatible = "sony,rt9120s_i2c";
				reg = <0x18>;
				status = "okay";
				phandle = <0x02>;
			};

			rt9120s_amp@19 {
				compatible = "sony,rt9120s_i2c";
				reg = <0x19>;
				status = "okay";
				phandle = <0x03>;
			};
		};
	};

	__symbols__ {
		sony_damp = "/fragment@1/__overlay__/sony_damp";
		rt9120s_0 = "/fragment@2/__overlay__/rt9120s_amp@18";
		rt9120s_1 = "/fragment@2/__overlay__/rt9120s_amp@19";
	};

	__fixups__ {
		mtk_sound_machine = "/fragment@0:target:0";
		odm = "/fragment@1:target:0";
		pm_gpio0 = "/fragment@1/__overlay__/sony_damp:ampmute-gpios:0\0/fragment@1/__overlay__/sony_damp:ampreset-gpios:0";
		gpio0 = "/fragment@1/__overlay__/sony_damp:headphonemute-gpios:0\0/fragment@1/__overlay__/sony_damp:amperrdet-gpios:0";
		i2c1 = "/fragment@2:target:0";
	};

	__local_fixups__ {

		fragment@0 {

			__overlay__ {
				audio-codec = <0x00>;
			};
		};

		fragment@1 {

			__overlay__ {

				sony_damp {
					damp = <0x00 0x04>;
				};
			};
		};
	};
};
